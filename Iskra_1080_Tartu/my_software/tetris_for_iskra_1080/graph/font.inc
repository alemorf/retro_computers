  .db   0,  0,  0,  0,  0,  0,  0,  0,  0,  0,  0,  0 ; 20h
  .db 192,192,  0, 96, 96,112, 48, 56, 56, 60, 28, 30 ; 21h !
  .db   0,  0,  0,  0,  0,  0,  0,  0,  0, 72,108,126 ; 22h "
  .db   0,108,108,254,108,108,108,254,108,108,  0,  0 ; 23h #
  .db  16, 60,118, 22,  6, 60, 96,104,110, 60,  8,  0 ; 24h $
  .db 196,206,100, 96, 48, 48, 24, 24, 12, 76,230, 70 ; 25h %
  .db 118,198,204,204, 88,120, 48, 56,108,108,108, 56 ; 26h &
  .db   0,  0,  0,  0,  0,  0,  0,  0,  0, 64, 96,112 ; 27h '
  .db  12, 24, 24, 24, 24, 24, 24, 24, 24, 24, 24, 12 ; 28h (
  .db  96, 48, 48, 48, 48, 48, 48, 48, 48, 48, 48, 96 ; 29h )
  .db   0,  0,  0,  0, 36, 24,126, 24, 36,  0,  0,  0 ; 2Ah *
  .db   0,  0,  0, 24, 24,126,126, 24, 24,  0,  0,  0 ; 2Bh +
  .db  64, 96,112,  0,  0,  0,  0,  0,  0,  0,  0,  0 ; 2Ch ,
  .db   0,  0,  0,  0,  0,126,126,  0,  0,  0,  0,  0 ; 2Dh -
  .db  32,112, 32,  0,  0,  0,  0,  0,  0,  0,  0,  0 ; 2Eh .
  .db 192,192, 96, 96, 48, 48, 24, 24, 12, 12,  6,  6 ; 2Fh /
  .db 124,198,198,198,198,198,198,198,198,198,198,124 ; 30h 0
  .db  60, 24, 24, 24, 24, 24, 24, 24, 24, 24, 56, 24 ; 31h 1
  .db 254,198,198,192,192,192,192,124,  6,198,198,124 ; 32h 2
  .db 124,198,198,198,  6,  6,  6, 28,  6,198,198,124 ; 33h 3
  .db   6,  6,  6,  6,  6,  6,  6,126,198,198,198,198 ; 34h 4
  .db 124,198,198,198,  6,  6,  6,252,192,192,198,254 ; 35h 5
  .db 124,198,198,198,198,198,198,252,192,198,198,124 ; 36h 6
  .db   6,  6,  6,  6,  6,  6,  6,  6,  6,198,198,124 ; 37h 7
  .db 124,198,198,198,198,198,198,124,198,198,198,124 ; 38h 8
  .db 124,198,198,  6,  6,  6,  6,126,198,198,198,124 ; 39h 9
  .db   0, 32,112, 32,  0,  0, 32,112, 32,  0,  0,  0 ; 3Ah :
  .db  64, 96,112,  0,  0,  0, 32,112, 32,  0,  0,  0 ; 3Bh ;
  .db   0,  0, 12, 24, 48, 96, 96, 48, 24, 12,  0,  0 ; 3Ch <
  .db   0,  0,  0,126,126,  0,  0,126,126,  0,  0,  0 ; 3Dh =
  .db   0,  0, 96, 48, 24, 12, 12, 24, 48, 96,  0,  0 ; 3Eh >
  .db  24, 24,  0, 24, 24, 24, 24, 12,  6,198,198,124 ; 3Fh ?
  .db 124,198,198,192,222,246,246,246,222,198,198,124 ; 40h @
  .db 198,198,198,198,198,198,198,254,198,198,198,124 ; 41h A
  .db 252,198,198,198,198,198,198,252,198,198,198,252 ; 42h B
  .db 124,198,198,192,192,192,192,192,192,198,198,124 ; 43h C
  .db 252,198,198,198,198,198,198,198,198,198,204,248 ; 44h D
  .db 124,198,198,192,192,192,192,240,192,198,198,124 ; 45h E
  .db 192,192,192,192,192,192,192,240,192,198,198,124 ; 46h F
  .db 124,198,198,198,206,192,192,192,192,198,198,124 ; 47h G
  .db 198,198,198,198,198,198,198,254,198,198,198,198 ; 48h H
  .db  60, 24, 24, 24, 24, 24, 24, 24, 24, 24, 24, 60 ; 49h I
  .db 124,198,198,198,198,  6,  6,  6,  6,  6,  6,  6 ; 4Ah J
  .db 198,198,198,198,198,198,204,248,204,198,198,198 ; 4Bh K
  .db 124,198,198,192,192,192,192,192,192,192,192,192 ; 4Ch L
  .db 198,198,198,198,198,198,198,214,214,238,198,130 ; 4Dh M
  .db 198,198,198,198,198,198,198,206,222,246,230,198 ; 4Eh N
  .db 124,198,198,198,198,198,198,198,198,198,198,124 ; 4Fh O
  .db 192,192,192,192,192,192,192,252,198,198,198,252 ; 50h P
  .db 118,204,218,198,198,198,198,198,198,198,198,124 ; 51h Q
  .db 198,198,198,198,198,198,204,248,204,198,198,252 ; 52h R
  .db 124,198,198,198,  6,  6,  6,124,192,192,198,124 ; 53h S
  .db  24, 24, 24, 24, 24, 24, 24, 24, 24, 24, 24,126 ; 54h T
  .db 124,198,198,198,198,198,198,198,198,198,198,198 ; 55h U
  .db  16, 56,108,198,198,198,198,198,198,198,198,198 ; 56h V
  .db  68,238,214,214,198,198,198,198,198,198,198,198 ; 57h W
  .db 198,198,198,198,198,198,108, 56,108,198,198,198 ; 58h X
  .db 124,198,198,  6,  6,  6,  6,126,198,198,198,198 ; 59h Y
  .db 254,192,192,192,192,192,192,124,  6,  6,  6,254 ; 5Ah Z