
  .db 0,145,30,255,3,182,12,109,255,30,26,212,255,59,255,189,27,255,31,254,128,192,96,48,24,12,6,245,255,0,148,255,199,1,3,143,7,13,31,29,63,241,115,225,1,255,236,0,120,255,127,221,3,15,31,30,60,120,30,240,61,224,44,255,96
  .db 161,255,241,39,235,231,60,28,224,15,3,0,90,64,166,255,65,255,67,204,90,255,65,35,231,192,246,240,31,6,122,255,134,60,198,127,230,102,118,182,199,190,94,143,46,22,28,228,149,127,128,140,81,9,211,150,255,112,176,184,216,92,108,46,54
  .db 241,23,27,11,5,227,2,199,1,101,63,106,254,251,203,201,205,206,144,202,251,172,200,85,255,252,216,255,7,128,50,199,169,112,218,120,88,0,255,60,47,192,1,7,86,115,221,252,7,179,1,6,239,220,252,118,145,220,216,90,255,223,3,53,255
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  .db 199,255,30,63,255,96,16