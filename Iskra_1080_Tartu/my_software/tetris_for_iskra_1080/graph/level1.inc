
  .db 255,199,128,254,19,8,239,29,137,191,248,220,251,243,163,80,162,156,82,252,3,211,8,112,28,215,170,119,105,221,254,79,250,181,74,29,42,140,55,212,252,229,238,0,187,255,17,221,255,64,131,15,62,249,224,128,34,22,232,29,226,232,252,40,7
  .db 244,8,16,236,96,128,0,125,255,128,143,192,224,178,96,68,254,241,176,203,93,49,255,180,0,221,32,119,170,85,46,254,0,8,10,220,0,99,239,128,150,83,166,252,115,0,81,42,198,80,40,255,3,7,31,124,242,194,130,2,24,88,186,229,156
  .db 39,254,17,229,1,6,246,8,16,32,192,40,7,255,224,240,120,188,94,175,87,171,115,146,213,234,246,245,250,253,254,163,254,126,252,236,248,224,128,29,92,0,9,238,237,46,131,250,249,36,11,208,248,252,248,239,239,170,117,96,0,223,171,16,252
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  .db 215,1,131,104,236,239,255,193,251,182,0,248,95,68,0,111,208,0,123,63,160,32,85,254,63,177,236,137,25,228,153,0,140,204,213,0,198,6,135,245,254,7,176,255,241,244,131,195,99,211,0,128,192,193,240,248,96,213,182,242,1