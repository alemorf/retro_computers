
  .db 48,30,32,152,255,64,1,210,0,255,24,79,3,251,129,6,3,62,2,80,127,248,116,72,153,217,156,191,226,28,30,143,127,39,75,125,124,249,254,126,143,127,255,22,63,47,159,15,227,31,14,219,243,193,90,0,225,240,51,15,180,128,255,155,241
  .db 232,118,63,236,103,199,232,251,127,191,223,32,194,249,231,224,252,203,183,230,33,32,65,185,16,23,66,1,7,240,8,2,13,18,190,34,69,138,85,170,193,13,254,42,77,252,10,21,237,244,213,234,33,250,186,33,254,246,140,245,3,12,94,178,247
  .db 246,240,241,49,253,143,249,253,248,248,244,236,237,221,241,189,229,125,21,63,255,56,72,146,0,128,8,22,192,33,62,255,73,18,38,133,1,8,68,4,227,10,0,112,127,25,240,125,53,252,254,180,255,246,179,63,241,152,67,79,125,252,50,55,216
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  .db 56,112,147,247,112,9,192,244,204,199,3,230,135,238,218,236,18,239,155,45,212,160,31,117,189,161,16,192,122,10,254,192,136,48,29,8