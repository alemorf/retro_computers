
  .db 192,255,152,67,80,48,8,4,247,62,255,119,231,15,14,255,63,254,215,27,253,238,27,229,250,247,181,106,85,170,61,254,84,144,128,0,148,255,129,37,8,110,244,123,230,5,7,208,10,4,236,72,16,124,64,2,3,27,1,84,225,2,25,38,234
  .db 185,3,246,33,60,237,136,87,255,255,234,63,131,56,252,216,238,110,233,60,23,10,169,255,203,119,200,227,97,167,223,2,76,226,249,22,248,185,172,236,10,172,6,231,182,39,228,32,184,36,3,145,2,248,63,128,32,129,193,136,216,255,220,191,62
  .db 120,12,21,2,16,216,3,255,126,255,255,33,191,126,251,230,128,243,17,199,15,8,15,240,153,255,56,25,7,187,127,42,223,243,78,231,189,250,213,211,251,254,172,64,47,248,253,16,8,214,34,130,4,247,61,37,230,64,44,255,180,8,72,226,6
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  .db 95,250,149,242,132,223,129,230,247,198,213,6,205,106,200,159,216,164,127,79,202,199,216,4,250,85,200,235,213,114,236,24,234,236,192,32