
  .db 0,122,255,16,63,32,96,64,3,1,7,251,79,223,159,55,119,147,255,247,255,251,108,255,227,255,254,252,237,253,250,159,254,245,234,209,128,160,241,21,0,136,68,65,206,28,224,198,2,5,0,199,250,18,65,10,32,1,235,196,20,232,241,226,255
  .db 31,224,121,193,209,197,255,243,5,4,0,3,225,1,56,251,32,31,226,167,235,63,129,220,255,111,54,24,141,199,163,80,168,141,84,128,179,0,26,255,32,16,123,254,80,160,85,170,8,16,254,69,56,65,2,64,223,0,46,117,254,255,34,113,13
  .db 234,146,213,254,234,195,115,254,52,120,7,12,28,24,0,167,38,255,65,67,63,30,31,148,255,15,255,231,71,167,87,254,171,83,27,81,169,140,85,126,205,84,82,106,40,68,115,20,128,31,254,2,230,12,16,0,25,224,63,50,193,240,133,16,63
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  .db 84,111,202,48,3,89,253,13,102,75,130,228,77,194,83,254,23,253,214,56,207,255,57,60,61,62,29,218,254,29,131,222,24,253,4