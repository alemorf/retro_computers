
  .db 0,143,128,135,241,208,143,163,155,124,148,191,252,240,255,254,192,236,248,120,188,176,178,220,130,0,255,188,6,250,131,222,56,250,7,140,98,240,192,227,5,110,255,143,1,192,63,254,195,128,130,2,152,255,241,0,46,211,163,190,198,183,200,208,64
  .db 214,132,231,47,112,198,50,192,255,76,128,161,176,171,224,12,120,241,251,254,126,127,176,63,255,6,207,252,248,162,251,224,236,62,185,199,31,99,255,60,247,194,253,119,253,111,191,95,171,85,170,187,254,234,149,161,106,254,248,96,214,254,227,0,29
  .db 14,113,60,63,61,133,143,15,51,23,27,31,32,255,120,159,63,29,255,28,223,222,95,110,156,110,254,20,238,63,124,255,103,253,255,190,248,28,111,155,252,189,30,206,195,191,73,254,248,190,245,209,255,30,28,243,206,49,57,126,194,2,255,177,79
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  .db 152,30,239,255,239,204,200,205,138,207,19,2,168,77,192,253,48,255,8