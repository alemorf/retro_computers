
  .db 255,  0,  0,255,  0,  0,156,  0, 99, 99,  0,156,156,  0, 99, 99,  0,156,255,  0,  0,255,  0,  0,156,  0, 99, 99,  0,156,156,  0, 99, 99,  0,156
  .db 255,  0,  0,255,  0,  0,  0,  0,255,  0,254,255,  0,102,103,  0,126,127,  0,102,103,  0,102,103,  0,230,231,  0,102,103,  0,254,255,  0,  0,255
  .db 255,  0,  0,255,  0,  0,  0,  0,255,  0,255,255,  0, 32, 32,  0,126,126,  0,126,126,  0, 96, 96,  0,103,103,  0, 32, 32,  0,255,255,  0,  0,255
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  .db 255,  0,  0,255,  0,  0,255,  0,  0,255,  0,  0,255,  0,  0,255,  0,  0,255,  0,  0,255,  0,  0,255,  0,  0,255,  0,  0,255,  0,  0,255,  0,  0
