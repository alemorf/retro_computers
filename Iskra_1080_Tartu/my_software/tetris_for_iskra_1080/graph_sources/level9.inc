
  .db 43,199,7,127,241,238,243,63,14,176,191,23,255,103,187,207,223,190,243,248,72,220,254,253,252,191,216,237,248,224,255,131,215,158,18,247,20,242,0,224,63,255,253,212,241,98,115,236,228,199,204,252,252,164,244,160,224,176,120,63,144,80,112,0,115
  .db 255,176,6,156,12,251,96,128,115,251,1,154,8,246,2,66,238,140,160,192,243,31,56,11,4,15,9,255,88,192,64,28,0,124,176,128,224,252,160,182,231,24,60,233,180,16,240,221,128,10,4,6,249,248,236,200,252,104,241,243,168,152,136,121,163
  .db 251,255,92,39,6,248,115,14,223,178,250,254,4,246,36,24,68,190,132,243,37,33,135,137,248,152,252,100,168,239,255,251,127,139,128,254,5,0,250,8,183,249,31,255,239,191,170,85,138,150,81,143,30,63,255,124,158,123,60,40,19,255,14,167,211
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  .db 242,236,233,2