
  .db 0,97,226,255,255,3,2,136,255,207,48,90,63,92,90,128,192,240,120,248,244,252,255,159,220,255,156,152,56,48,199,112,224,217,192,128,44,223,56,120,123,248,32,255,108,243,56,27,220,90,128,248,255,126,63,15,7,217,255,15,201,31,63,240,81
  .db 254,241,227,199,15,62,120,240,202,111,85,1,3,123,227,254,252,248,224,7,15,145,180,108,153,202,150,7,33,87,255,114,240,1,15,127,252,217,170,227,3,88,230,254,55,169,90,31,138,240,217,224,128,203,116,15,199,86,92,129,15,235,31,124,240
  .db 236,1,143,37,227,233,127,131,123,90,192,193,209,231,239,135,223,54,30,240,99,81,192,183,255,30,7,31,63,188,127,231,62,249,251,60,250,23,28,255,94,236,63,31,7,111,248,14,192,64,199,51,252,244,25,123,65,62,58,26,48,63,96,248,232
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  .db 180,3,192,151,47,90,97,120,63,99,245,3,15,28,180,204,241,96,16