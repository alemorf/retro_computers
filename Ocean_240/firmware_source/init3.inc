; ПЗУ Океан 240.2 REV 8 / Реверсинжиниринг aleksey.f.morozov@gmail.com / Лицензия GPL
; Инициализация компьютера

; Строка инициализации видео. Так же содержит приветствие.

a_hello: .db 1Bh, '6', '0'                      ; Выбор режима экрана
         .db 1Bh, '8', '3'                      ; Выбор палитры
         .db 1Bh, '5', '!', '%'                 ; Установка положения курсора
         .db 1Bh, '4', '1'                      ; Выбор цвета
         .db 1Bh, '1', 16h, 0E2h, 0E2h, 0FCh, 1 ; Рисование прямоугольника
         .db 1Bh, '4', '0'                      ; Выбор цвета
         .db 1Bh, '1', 1Eh, 0E6h, 0DBh, 0F8h, 1 ; Рисование прямоугольника
         .db 1Bh, '4', '3'                      ; Выбор цвета
#ifdef CONFIG_HELLO_MESSAGE
         .db CONFIG_HELLO_MESSAGE
#else
         .db "OKEAH-240 CP/M (V2.2) REL.8'"
#endif
         .db "\r\n\n"
         .db 1Bh, '4', '2', 0                   ; Выбор цвета
