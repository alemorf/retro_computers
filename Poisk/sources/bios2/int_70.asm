;-------INT 70 (LEVEL 8)--------------------------------------------
;	THIS ROUTINE HANDLES THE PERIODIC AND ALARM INTERRUPTS FROM
;	THE NON-VOLATILE TIMER. INPUT FREQUENCY IS 1024 KHZ OR
;	APPROXIMATELY 1024 INTERRUPTS EVERY SECOND FOR THE PERIODIC
;	INTERRUPT. FOR THE ALARM FUNCTION, AN INTERRUPT WILL OCCUR
;	AT THE DESIGNATED TIME.
;
;	THE INTERRUPT IS ENABLED ONLY WHEN EVENT OR ALARM FUNCTIONS
;	ARE ACTIVE.
;	FOR THE EVENT INTERRUPT, THE HANDLER WILL DECREMENT THE WAIT
;	COUNTER AND WHEN IT EXPIRES WILL TURN ON THE HIGH ORDER BIT
;	OF THE DESIGNATED FLAG.
;	FOR THE ALARM INTERRUPT, THE USER ROUTINE WILL BE INVOKED
;	THROUGH INT 4AH. THE USER MUST CODE A ROUTINE AND PLACE THE
;	CORRECT ADDRESS IN THE VECTOR TABLE.
;-------------------------------------------------------------------
RTC_INT  PROC  FAR
	assume	cs:code,ds:data
  STI				;INTERRUPTS BACK ON
  PUSH	 DS			;SAVE REGISTERS
  PUSH	 AX
  PUSH	 DX
  PUSH	 DI
  call	dds
  MOV	 DL,0AH 		;GET ENABLES
  CALL	 PORT_INC
  IN	 AL,CMOS_PORT+1
  MOV	 AH,AL			;SAVE
  CALL	 PORT_INC		;GET SOURCE
  IN	 AL,CMOS_PORT+1
 ; push	 ax
  AND	 AL,AH
  PUSH	 AX			;SAVE
  TEST	 AL,40H 		;CHECK FOR PERIODIC INTERRUPT
  JZ	 RTC_INT_9		;NO - GO AROUND
  CALL	 DDS			;ESTABLISH ADDRESSABILITY
  SUB	 RTC_LOW,0976		;DECREMENT COUNT
  SBB	 RTC_HIGH,0
  JA	 RTC_INT_9
  MOV	 DL,0AH 		;TURN OFF PIE
  CALL	 PORT_INC
  IN	 AL,CMOS_PORT+1
  AND	 AL,0BFH
  PUSH	 AX
  MOV	 DL,0AH
  CALL	 PORT_INC
  POP	 AX
  OUT	 CMOS_PORT+1,AL
  MOV	 RTC_WAIT_FLAG,0	;SET FUNCTION ACTIVE FLAG OFF
  LDS	 DI,DWORD PTR USER_FLAG ;SET UP DS,DI TO POINT TO USER FLAG
  MOV	 BYTE PTR[DI],80H	;TURN ON USERS FLAG
RTC_INT_9:
  POP	 AX			;GET INTERRUPT SOURCE BACK
  TEST	 AL,20H 		;TEST FOR ALARM INTERRUPT
  JZ	 RTC_INT_10		;NO - GO AROUND
  INT	 4AH			;TRANSFER TO USER ROUTINE
RTC_INT_10:
  MOV	 AL,EOI 		;END OF INTERRUPT TO 8259 - 2
  OUT	 020H,AL		;AND TO 8259 - 1
  POP	 DI			;RESTORE REGISTERS
  POP	 DX
  POP	 AX
  POP	 DS
  IRET				;END OF INTERRUPT
RTC_INT  ENDP
