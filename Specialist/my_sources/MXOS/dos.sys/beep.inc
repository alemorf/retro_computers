;+---------------------------------------------------------------------------
; MXOS
; Звуковой сигнал (вызывается при выводе кода 7)
;
; Все регистры сохраняются
;
; 2013-12-12 Дизассемблировано vinxru
;----------------------------------------------------------------------------

beep:		; Сохраняем все регистры. DE не используется ниже
		push	psw
		push	b
		push	h

		; Частота и длительность сигнала
		lhld	v_beep

beep_0:		; Единицу на динамик
		mvi	a, 0Bh
		sta	IO_KEYB_MODE

		; Задержка L тактов
		call	delay_l

		; Ноль на динамик
		mvi	a, 0Ah
		sta	IO_KEYB_MODE

		; Задержка L тактов
		call	delay_l

		; Повторяем H раз
		dcr	h
		jnz	beep_0

		; Ничего не делаем
		nop

		; Восстаналиваем все регистры и выходим. DE не используется
		pop	h
		pop	b
		pop	psw
		ret