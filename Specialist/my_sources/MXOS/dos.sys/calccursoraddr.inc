;+---------------------------------------------------------------------------
; MXOS
; Расчет адреса курсора в видеопамяти. И перевод строки, если курсор был
; за правым краем экрана.
;
; На выходе
;  hl - координаты курсора
;  a * 256 + l - адрес в видеопамяти
;
; 2013-12-12 Дизассемблировано vinxru
;----------------------------------------------------------------------------

calcCursorAddr:	; В HL положение курсора
		lhld	v_cursorY

		; Если cursorX >= 190, то перевод строки (вывод кода 10)
		; Иначе рассчитываем адрес старшего байта a = cursorX / 4 + 90h
		mov	a, h
		cpi	190
		jc	calcCursorAd_1
		mvi	c, 10
		jmp	calcCursorAd_0
