;+---------------------------------------------------------------------------
; MXOS
; Сранивать расширения файлов
;
; На входе
;  de - адрес расширения 1
;  v_fileName_ext - расширение 2
;
; На выходе
;  zf=0 - расширения равны
;  de - de+3
;
; 2013-12-12 Дизассемблировано vinxru
;----------------------------------------------------------------------------

cmpFileExt:	lxi	h, v_fileName_ext

		; Сравниваем 3 символа
                lxi	b, 3
cmpFileExt_0:	ldax	d
		cmp	m
		jnz	cmpFileExt_1
		inx	h
		inx	d
		dcr	c
		jnz	cmpFileExt_0

		; ZF=1 если равны

cmpFileExt_1:	; Делаем так, что бы DE на выходе функции был на 3 больше, 
		; чем на входе в функцию
		push	psw
		xchg
		dad	b
		xchg
		pop	psw

		; Выход
		ret