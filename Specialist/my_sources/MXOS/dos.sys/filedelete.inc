;+---------------------------------------------------------------------------
; MXOS
; Удаление файла
;
; На входе
;  hl - имя файла
;
; На выходе
;  cf - ошибка
;  bc,de,hl - сохраняются
;
; 2013-12-12 Дизассемблировано vinxru
;----------------------------------------------------------------------------

fileDelete:	; Найти файл с именем из HL
		call	fileFind
		rc

		; Удалить файл
		call	deleteFileInt

		; Сохранить изменения на диск
		call	saveFatDir

		; Результат
		ora	a
		ret
		
; ---------------------------------------------------------------------------

deleteFileInt:	; Сохраняем регистры
		push	h
		push	b
		push	d

		; Помечаем файл, как удаленный заменяя его первую букву на FF
		lhld	v_foundedFile
		mvi	m, 0FFh		

		; Получаем первый кластер файла в A
		lxi	d, 15
		dad	d
		mov	a, m

		; Адрес таблицы FAT
		mvi	h, fat>>8

deleteFileIn_0:	; Получаем следующий кластер в А
		mov	l, a
		mov	a, m

		; А этот помечаем не занятым
		mvi	m, 0

		; Если это был не последний кластер, продолжаем.
		cmp	l
		jnz	deleteFileIn_0

		; Восстаналиваем регистры и выходим
		jmp	pop_dbh_ret		