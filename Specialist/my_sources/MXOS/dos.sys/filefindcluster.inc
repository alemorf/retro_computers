;+---------------------------------------------------------------------------
; MXOS
; Поиск свободного кластера 
;
; На выходе
;  cf - ошибка
;  a - кластер
;  регистры BC,DE,HL сохраняются
;
; 2013-12-12 Дизассемблировано vinxru
;----------------------------------------------------------------------------

fileFindClusterFirst:
		; Сохраняем регистры
		push	h

		; Начинаем поиск с первого кластера (первые 4 не используются)
		lxi	h,  fat + 4
		jmp	fileFindClus_2

;----------------------------------------------------------------------------
; Продолжение поиска свободного кластера 
;
; На выходе
;  cf - ошибка
;  a - кластер
;  регистры BC,DE,HL сохраняются
;----------------------------------------------------------------------------

fileFindClusterNext:
		; Сохраняем регистры
		push	h

		; Начинаем поиск с этого кластера
		lhld	v_findCluster

		; Ищем свободный кластер
		; В соответствующей ячейке таблицы FAT должен быть 0
fileFindClus_2:	xra	a
fileFindClus_0:	cmp	m
		jz	fileFindClus_1	; Найден
		inr	l
		jnz	fileFindClus_0

		; Восстаналиваем регистры и выходим A=1, CF=1, ZF=0
		pop	h
		mvi	a, 1
		stc
		ret

; ---------------------------------------------------------------------------

fileFindClus_1:	; Свобожный кластер найден
		mov	a, l

		; Устаналиваем ZF=0. Номер кластера не может быть нулевым.
		; В случае ошибки мы то же выходим с ZF=1
		ora	a

		; Для ускорения поиска сохраняем номер следующего кластера в v_findCluster
		inr	l
		shld	v_findCluster

		; Восстанавливаем регистры и выходим с CF=0, ZF=0
		pop	h
		ret