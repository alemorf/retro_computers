;+---------------------------------------------------------------------------
; MXOS
; Получение/изменение адреса загрузки файла
;
; На входе 
;   hl - имя файла
;   с  - 0=чтение, 1=изменение
;   de - адрес
;
; На выходе 
;   de - адрес
;   bc,hl - сохраняются
;
; 2013-12-12 Дизассемблировано vinxru
;----------------------------------------------------------------------------

fileGetSetAddr:	; Ищем файл с именем в HL
		call	fileFind
		rc

		push	h

		; Получаем адрес где находится длина файла
		call	fileGetInfoAddr
		inx	h

		; Переходим, если на входе в функцию C=0
		jnz	fileGetSetAd_0

		; Заменяем адрес загрузки
		mov	m, e
		inx	h
		mov	m, d

		; Сохраняем изменения
		call	saveFatDir

		; Выходим
		pop	h
		ora	a
		ret

; ---------------------------------------------------------------------------

fileGetSetAd_0:	; Читаем адрес загрузки
		mov	e, m
		inx	h
		mov	d, m

		; Выходим
		pop	h
		ora	a
		ret
