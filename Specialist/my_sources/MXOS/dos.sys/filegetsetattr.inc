;+---------------------------------------------------------------------------
; MXOS
; Получение/изменение атрибутов файла
;
; На входе 
;   hl - имя файла
;   с  - 0=чтение, 1=изменение
;   b  - новые атрибуты (если C==1)
;
; На выходе 
;   cf - ошибка
;   a  - атрибуты
;   bc,de,hl - сохраняются
;
; 2013-12-12 Дизассемблировано vinxru
;----------------------------------------------------------------------------

fileGetSetAttr:	push	b
		mov	b, a		

		; Ищем файл с именем в HL. Если найден, то переходим
		call	fileFind
		jnc	fileGetSetAt_0

		; Ошибка, выходим
		pop	b
		ret

; ---------------------------------------------------------------------------

fileGetSetAt_0:	push	h
		call	fileGetInfoAddr

		; Переходим, если на входе в функцию C=0
		jnz	fileGetSetAt_1

		; Устанавливаем флаги
		mov	m, b

fileGetSetAt_1:	; Читаем флаги
		mov	a, m

		; Сохраняем изменения (хотя для чтения это не нужно делать)
		call	saveFatDir

		; Восстанавливаем регистры и выходим ;! А тут точно CF==0 будет?
		ora	a
		pop	h
		pop	b
		ret