initFont:	lxi	h, reboot2
		shld	onceInitFont+1
		push	h

		lxi	h, font
		lxi	d, fontEnd
		lxi	b, FONT_ADDR
		jmp	memcpy_bc_hl

font:
	.db 000h,000h,000h,000h,000h,000h,000h,000h ; 0
	.db 004h,00Eh,015h,004h,015h,00Eh,004h,000h ; 1
	.db 000h,000h,004h,00Ah,01Fh,000h,01Fh,000h ; 2
	.db 000h,000h,01Fh,00Ah,004h,000h,01Fh,000h ; 3
	.db 009h,01Bh,02Dh,01Bh,009h,000h,000h,000h ; 4
	.db 024h,036h,02Dh,036h,024h,000h,000h,000h ; 5
	.db 01Eh,021h,02Dh,029h,02Dh,021h,01Eh,000h ; 6
	.db 010h,018h,017h,015h,017h,018h,010h,000h ; 7
	.db 000h,000h,004h,008h,01Fh,008h,004h,000h ; 8
	.db 000h,000h,014h,012h,01Fh,012h,014h,000h ; 9
	.db 013h,012h,013h,01Ah,000h,01Fh,000h,000h ; 10
	.db 000h,000h,000h,000h,000h,000h,000h,000h ; 11
	.db 01Ch,018h,014h,002h,001h,001h,001h,000h ; 12
	.db 01Fh,001h,001h,005h,009h,01Fh,008h,004h ; 13
	.db 003h,004h,004h,01Ch,03Ch,018h,000h,000h ; 14
	.db 003h,009h,005h,03Fh,005h,009h,003h,000h ; 15
	.db 003h,009h,011h,03Fh,011h,009h,003h,000h ; 16
	.db 004h,00Ah,011h,00Ah,004h,000h,000h,000h ; 17
	.db 011h,011h,011h,011h,011h,000h,011h,000h ; 18
	.db 000h,000h,000h,000h,000h,011h,011h,000h ; 19
	.db 000h,008h,000h,008h,000h,008h,000h,000h ; 20
	.db 004h,004h,000h,01Fh,000h,004h,004h,000h ; 21
	.db 00Fh,008h,008h,008h,008h,028h,010h,000h ; 22
	.db 03Fh,000h,000h,000h,000h,000h,000h,000h ; 23
	.db 000h,000h,004h,002h,01Fh,002h,004h,000h ; 24
	.db 004h,00Eh,015h,004h,004h,004h,004h,000h ; 25
	.db 004h,004h,004h,004h,015h,00Eh,004h,000h ; 26
	.db 01Bh,012h,01Ah,012h,01Bh,000h,01Fh,000h ; 27
	.db 03Fh,001h,000h,000h,000h,000h,000h,000h ; 28
	.db 000h,000h,000h,000h,000h,000h,000h,000h ; 29
	.db 000h,000h,000h,000h,000h,000h,000h,000h ; 30
	.db 01Fh,011h,019h,015h,013h,011h,01Fh,000h ; 31
	.db 000h,000h,000h,000h,000h,000h,000h,000h ; 32
	.db 004h,004h,004h,004h,004h,000h,004h,000h ; 33
	.db 00Ah,00Ah,00Ah,000h,000h,000h,000h,000h ; 34
	.db 00Ah,00Ah,01Fh,00Ah,01Fh,00Ah,00Ah,000h ; 35
	.db 004h,00Fh,014h,00Eh,005h,01Eh,004h,000h ; 36
	.db 010h,011h,002h,004h,008h,011h,001h,000h ; 37
	.db 004h,00Ah,00Ah,00Ch,015h,012h,00Dh,000h ; 38
	.db 000h,002h,002h,004h,000h,000h,000h,000h ; 39
	.db 002h,004h,008h,008h,008h,004h,002h,000h ; 40
	.db 008h,004h,002h,002h,002h,004h,008h,000h ; 41
	.db 000h,004h,015h,00Eh,015h,004h,000h,000h ; 42
	.db 000h,004h,004h,01Fh,004h,004h,000h,000h ; 43
	.db 000h,000h,000h,000h,000h,004h,004h,008h ; 44
	.db 000h,000h,000h,01Fh,000h,000h,000h,000h ; 45
	.db 000h,000h,000h,000h,000h,004h,004h,000h ; 46
	.db 000h,001h,002h,004h,008h,010h,000h,000h ; 47
	.db 00Eh,011h,013h,015h,019h,011h,00Eh,000h ; 48
	.db 004h,00Ch,004h,004h,004h,004h,00Eh,000h ; 49
	.db 00Eh,011h,001h,006h,008h,010h,01Fh,000h ; 50
	.db 01Fh,001h,002h,006h,001h,011h,00Eh,000h ; 51
	.db 002h,006h,00Ah,012h,01Fh,002h,002h,000h ; 52
	.db 01Fh,010h,01Eh,001h,001h,011h,00Eh,000h ; 53
	.db 007h,008h,010h,01Eh,011h,011h,00Eh,000h ; 54
	.db 01Fh,001h,002h,004h,008h,008h,008h,000h ; 55
	.db 00Eh,011h,011h,00Eh,011h,011h,00Eh,000h ; 56
	.db 00Eh,011h,011h,00Fh,001h,002h,01Ch,000h ; 57
	.db 000h,004h,004h,000h,000h,004h,004h,000h ; 58
	.db 000h,004h,004h,000h,000h,004h,004h,008h ; 59
	.db 002h,004h,008h,010h,008h,004h,002h,000h ; 60
	.db 000h,000h,01Fh,000h,01Fh,000h,000h,000h ; 61
	.db 008h,004h,002h,001h,002h,004h,008h,000h ; 62
	.db 00Eh,011h,001h,002h,004h,000h,004h,000h ; 63
	.db 00Eh,011h,013h,015h,017h,010h,00Eh,000h ; 64
	.db 004h,00Ah,011h,011h,01Fh,011h,011h,000h ; 65
	.db 01Eh,011h,011h,01Eh,011h,011h,01Eh,000h ; 66
	.db 00Eh,011h,010h,010h,010h,011h,00Eh,000h ; 67
	.db 01Eh,009h,009h,009h,009h,009h,01Eh,000h ; 68
	.db 01Fh,010h,010h,01Eh,010h,010h,01Fh,000h ; 69
	.db 01Fh,010h,010h,01Eh,010h,010h,010h,000h ; 70
	.db 00Eh,011h,010h,010h,013h,011h,00Fh,000h ; 71
	.db 011h,011h,011h,01Fh,011h,011h,011h,000h ; 72
	.db 00Eh,004h,004h,004h,004h,004h,00Eh,000h ; 73
	.db 001h,001h,001h,001h,011h,011h,00Eh,000h ; 74
	.db 011h,012h,014h,018h,014h,012h,011h,000h ; 75
	.db 010h,010h,010h,010h,010h,011h,01Fh,000h ; 76
	.db 011h,01Bh,015h,015h,011h,011h,011h,000h ; 77
	.db 011h,011h,019h,015h,013h,011h,011h,000h ; 78
	.db 00Eh,011h,011h,011h,011h,011h,00Eh,000h ; 79
	.db 01Eh,011h,011h,01Eh,010h,010h,010h,000h ; 80
	.db 00Eh,011h,011h,011h,015h,012h,00Dh,000h ; 81
	.db 01Eh,011h,011h,01Eh,014h,012h,011h,000h ; 82
	.db 00Eh,011h,010h,00Eh,001h,011h,00Eh,000h ; 83
	.db 01Fh,004h,004h,004h,004h,004h,004h,000h ; 84
	.db 011h,011h,011h,011h,011h,011h,00Eh,000h ; 85
	.db 011h,011h,011h,00Ah,00Ah,004h,004h,000h ; 86
	.db 011h,011h,011h,015h,015h,015h,00Ah,000h ; 87
	.db 011h,011h,00Ah,004h,00Ah,011h,011h,000h ; 88
	.db 011h,011h,00Ah,004h,004h,004h,004h,000h ; 89
	.db 01Fh,001h,002h,00Eh,008h,010h,01Fh,000h ; 90
	.db 00Eh,008h,008h,008h,008h,008h,00Eh,000h ; 91
	.db 000h,010h,008h,004h,002h,001h,000h,000h ; 92
	.db 00Eh,002h,002h,002h,002h,002h,00Eh,000h ; 93
	.db 004h,00Ah,011h,000h,000h,000h,000h,000h ; 94
	.db 000h,000h,000h,000h,000h,000h,000h,000h ; 95
	.db 000h,00Fh,000h,006h,009h,009h,006h,000h ; 96
	.db 000h,000h,00Ch,002h,00Eh,012h,00Dh,000h ; 97
	.db 008h,008h,008h,00Eh,009h,009h,016h,000h ; 98
	.db 000h,000h,00Eh,011h,010h,011h,00Eh,000h ; 99
	.db 002h,002h,002h,00Eh,012h,012h,00Dh,000h ; 100
	.db 000h,000h,00Eh,011h,01Fh,010h,00Eh,000h ; 101
	.db 006h,009h,008h,01Ch,008h,008h,008h,000h ; 102
	.db 000h,000h,00Dh,012h,012h,00Eh,002h,01Ch ; 103
	.db 010h,010h,010h,01Eh,011h,011h,011h,000h ; 104
	.db 000h,010h,000h,010h,010h,011h,00Eh,000h ; 105
	.db 000h,001h,000h,001h,001h,001h,011h,00Eh ; 106
	.db 010h,010h,011h,012h,01Ch,012h,011h,000h ; 107
	.db 010h,010h,010h,010h,010h,011h,00Eh,000h ; 108
	.db 000h,000h,01Ah,015h,015h,015h,015h,000h ; 109
	.db 000h,000h,016h,019h,011h,011h,011h,000h ; 110
	.db 000h,000h,00Eh,011h,011h,011h,00Eh,000h ; 111
	.db 000h,000h,016h,009h,009h,00Eh,008h,008h ; 112
	.db 000h,000h,00Dh,012h,012h,00Eh,002h,002h ; 113
	.db 000h,000h,016h,009h,008h,008h,008h,000h ; 114
	.db 000h,000h,00Eh,010h,00Eh,001h,00Eh,000h ; 115
	.db 008h,008h,01Ch,008h,008h,009h,006h,000h ; 116
	.db 000h,000h,012h,012h,012h,012h,00Dh,000h ; 117
	.db 000h,000h,011h,011h,011h,00Ah,004h,000h ; 118
	.db 000h,000h,015h,015h,015h,015h,00Ah,000h ; 119
	.db 000h,000h,011h,00Ah,004h,00Ah,011h,000h ; 120
	.db 000h,000h,011h,011h,011h,00Fh,001h,00Eh ; 121
	.db 000h,000h,01Fh,001h,00Eh,010h,01Fh,000h ; 122
	.db 003h,004h,004h,018h,004h,004h,003h,000h ; 123
	.db 01Fh,011h,011h,011h,011h,011h,01Fh,000h ; 124
	.db 018h,004h,004h,003h,004h,004h,018h,000h ; 125
	.db 000h,000h,008h,015h,002h,000h,000h,000h ; 126
	.db 001h,003h,007h,00Fh,007h,003h,001h,000h ; 127
	.db 000h,000h,00Ah,01Fh,01Fh,00Eh,004h,000h ; 128
	.db 000h,004h,004h,01Fh,004h,004h,01Bh,000h ; 129
	.db 004h,00Eh,01Fh,01Fh,00Ah,004h,01Bh,000h ; 130
	.db 000h,000h,004h,00Eh,01Fh,00Eh,004h,000h ; 131
	.db 002h,004h,00Ah,015h,011h,011h,00Eh,000h ; 132
	.db 00Eh,004h,01Fh,015h,004h,00Ah,011h,000h ; 133
	.db 003h,004h,006h,009h,006h,002h,00Ch,000h ; 134
	.db 007h,003h,005h,00Ch,012h,012h,00Ch,000h ; 135
	.db 00Eh,011h,011h,00Eh,004h,00Eh,004h,000h ; 136
	.db 000h,017h,014h,01Fh,005h,01Dh,000h,000h ; 137
	.db 004h,004h,01Fh,004h,014h,00Ch,006h,005h ; 138
	.db 004h,01Fh,004h,00Ah,011h,01Fh,004h,000h ; 139
	.db 004h,01Fh,005h,00Ah,011h,01Fh,004h,000h ; 140
	.db 004h,004h,01Fh,000h,01Fh,004h,004h,000h ; 141
	.db 004h,00Eh,00Ah,00Ah,00Ah,00Eh,004h,000h ; 142
	.db 004h,006h,001h,006h,001h,006h,004h,000h ; 143
	.db 000h,000h,000h,03Fh,03Fh,000h,000h,000h ; 144
	.db 030h,030h,030h,030h,030h,030h,030h,030h ; 145
	.db 003h,003h,003h,003h,003h,003h,003h,003h ; 146
	.db 030h,030h,030h,03Fh,03Fh,030h,030h,030h ; 147
	.db 003h,003h,003h,03Fh,03Fh,003h,003h,003h ; 148
	.db 000h,000h,000h,03Fh,03Fh,030h,030h,030h ; 149
	.db 000h,000h,000h,03Fh,03Fh,003h,003h,003h ; 150
	.db 003h,003h,003h,03Fh,03Fh,000h,000h,000h ; 151
	.db 030h,030h,030h,03Fh,03Fh,000h,000h,000h ; 152
	.db 000h,000h,000h,03Fh,03Fh,018h,018h,018h ; 153
	.db 018h,018h,018h,018h,018h,018h,018h,018h ; 154
	.db 018h,018h,018h,03Fh,03Fh,000h,000h,000h ; 155
	.db 018h,018h,018h,03Fh,03Fh,018h,018h,018h ; 156
	.db 000h,000h,001h,002h,014h,008h,000h,000h ; 157
	.db 000h,000h,000h,000h,000h,000h,000h,000h ; 158
	.db 000h,000h,000h,000h,000h,000h,000h,000h ; 159
	.db 002h,002h,00Ah,016h,012h,012h,00Dh,000h ; 160
	.db 006h,009h,00Eh,009h,00Eh,008h,010h,000h ; 161
	.db 01Fh,011h,011h,010h,010h,010h,010h,000h ; 162
	.db 00Fh,010h,012h,00Ah,00Ah,00Ah,011h,000h ; 163
	.db 01Fh,008h,004h,002h,004h,008h,01Fh,000h ; 164
	.db 005h,00Ah,010h,01Eh,011h,011h,00Eh,000h ; 165
	.db 009h,009h,009h,009h,00Fh,009h,010h,000h ; 166
	.db 008h,014h,004h,002h,006h,009h,011h,000h ; 167
	.db 015h,015h,015h,00Eh,004h,004h,004h,000h ; 168
	.db 00Eh,011h,01Bh,01Fh,01Bh,011h,00Eh,000h ; 169
	.db 00Eh,011h,011h,00Eh,004h,015h,01Bh,000h ; 170
	.db 006h,009h,009h,006h,000h,000h,000h,000h ; 171
	.db 00Eh,013h,015h,019h,00Eh,000h,000h,000h ; 172
	.db 002h,006h,002h,002h,007h,000h,000h,000h ; 173
	.db 006h,009h,002h,004h,00Fh,000h,000h,000h ; 174
	.db 00Fh,001h,002h,009h,006h,000h,000h,000h ; 175
	.db 00Ah,00Ah,00Fh,002h,002h,000h,000h,000h ; 176
	.db 00Eh,008h,00Eh,001h,00Eh,000h,000h,000h ; 177
	.db 006h,008h,00Eh,009h,006h,000h,000h,000h ; 178
	.db 00Fh,001h,002h,004h,004h,000h,000h,000h ; 179
	.db 006h,009h,006h,009h,006h,000h,000h,000h ; 180
	.db 006h,009h,007h,001h,006h,000h,000h,000h ; 181
	.db 000h,000h,00Eh,013h,015h,019h,00Eh,000h ; 182
	.db 000h,000h,002h,006h,002h,002h,007h,000h ; 183
	.db 000h,000h,006h,009h,002h,004h,00Fh,000h ; 184
	.db 000h,000h,00Fh,001h,002h,009h,006h,000h ; 185
	.db 000h,000h,00Ah,00Ah,00Fh,002h,002h,000h ; 186
	.db 000h,000h,00Eh,008h,00Eh,001h,00Eh,000h ; 187
	.db 000h,000h,006h,008h,00Eh,009h,006h,000h ; 188
	.db 000h,000h,00Fh,001h,002h,004h,004h,000h ; 189
	.db 000h,000h,006h,009h,006h,009h,006h,000h ; 190
	.db 000h,000h,006h,009h,007h,001h,006h,000h ; 191
	.db 000h,000h,012h,015h,01Dh,015h,012h,000h ; 192
	.db 000h,000h,00Ch,002h,00Eh,012h,00Dh,000h ; 193
	.db 001h,00Eh,010h,01Eh,011h,011h,00Eh,000h ; 194
	.db 000h,000h,012h,012h,012h,012h,00Fh,001h ; 195
	.db 00Eh,001h,001h,00Fh,011h,011h,00Eh,000h ; 196
	.db 000h,000h,00Eh,011h,01Fh,010h,00Eh,000h ; 197
	.db 000h,000h,00Eh,015h,015h,00Eh,004h,004h ; 198
	.db 000h,000h,00Ch,012h,004h,009h,006h,000h ; 199
	.db 000h,000h,011h,00Ah,004h,00Ah,011h,000h ; 200
	.db 000h,000h,012h,012h,012h,012h,00Dh,000h ; 201
	.db 00Ch,000h,012h,012h,012h,012h,00Dh,000h ; 202
	.db 000h,000h,011h,012h,01Ch,012h,011h,000h ; 203
	.db 000h,000h,007h,009h,009h,009h,011h,000h ; 204
	.db 000h,000h,011h,01Bh,015h,011h,011h,000h ; 205
	.db 000h,000h,011h,011h,01Fh,011h,011h,000h ; 206
	.db 000h,000h,00Eh,011h,011h,011h,00Eh,000h ; 207
	.db 000h,000h,01Fh,011h,011h,011h,011h,000h ; 208
	.db 000h,000h,00Fh,011h,00Fh,009h,011h,000h ; 209
	.db 000h,000h,01Eh,011h,011h,01Eh,010h,000h ; 210
	.db 000h,000h,00Eh,011h,010h,011h,00Eh,000h ; 211
	.db 000h,000h,01Fh,004h,004h,004h,004h,000h ; 212
	.db 000h,000h,011h,011h,00Fh,001h,001h,00Eh ; 213
	.db 000h,000h,015h,015h,00Eh,015h,015h,000h ; 214
	.db 00Ch,014h,018h,01Eh,011h,011h,00Eh,000h ; 215
	.db 000h,000h,010h,010h,01Eh,011h,01Eh,000h ; 216
	.db 000h,000h,011h,011h,01Dh,013h,01Dh,000h ; 217
	.db 000h,000h,00Eh,011h,006h,011h,00Eh,000h ; 218
	.db 000h,000h,011h,015h,015h,015h,01Fh,000h ; 219
	.db 000h,000h,01Eh,001h,007h,001h,01Eh,000h ; 220
	.db 000h,000h,015h,015h,015h,015h,01Fh,001h ; 221
	.db 000h,000h,011h,011h,00Fh,001h,001h,000h ; 222
	.db 000h,000h,018h,008h,00Eh,009h,00Eh,000h ; 223
	.db 012h,015h,015h,01Dh,015h,015h,012h,000h ; 224
	.db 00Eh,011h,011h,011h,01Fh,011h,011h,000h ; 225
	.db 01Fh,010h,010h,01Eh,011h,011h,01Eh,000h ; 226
	.db 012h,012h,012h,012h,012h,012h,01Fh,001h ; 227
	.db 006h,00Ah,00Ah,00Ah,00Ah,01Fh,011h,000h ; 228
	.db 01Fh,010h,010h,01Eh,010h,010h,01Fh,000h ; 229
	.db 004h,01Fh,015h,015h,01Fh,004h,004h,000h ; 230
	.db 01Fh,011h,010h,010h,010h,010h,010h,000h ; 231
	.db 011h,011h,00Ah,004h,00Ah,011h,011h,000h ; 232
	.db 011h,011h,013h,015h,019h,011h,011h,000h ; 233
	.db 015h,011h,013h,015h,019h,011h,011h,000h ; 234
	.db 011h,012h,014h,018h,014h,012h,011h,000h ; 235
	.db 007h,009h,009h,009h,009h,009h,019h,000h ; 236
	.db 011h,01Bh,015h,015h,011h,011h,011h,000h ; 237
	.db 011h,011h,011h,01Fh,011h,011h,011h,000h ; 238
	.db 00Eh,011h,011h,011h,011h,011h,00Eh,000h ; 239
	.db 01Fh,011h,011h,011h,011h,011h,011h,000h ; 240
	.db 00Fh,011h,011h,00Fh,005h,009h,011h,000h ; 241
	.db 01Eh,011h,011h,01Eh,010h,010h,010h,000h ; 242
	.db 00Eh,011h,010h,010h,010h,011h,00Eh,000h ; 243
	.db 01Fh,004h,004h,004h,004h,004h,004h,000h ; 244
	.db 011h,011h,011h,00Ah,004h,008h,010h,000h ; 245
	.db 011h,015h,015h,00Eh,015h,015h,011h,000h ; 246
	.db 01Eh,011h,011h,01Eh,011h,011h,01Eh,000h ; 247
	.db 010h,010h,010h,01Eh,011h,011h,01Eh,000h ; 248
	.db 011h,011h,011h,019h,015h,015h,019h,000h ; 249
	.db 00Eh,011h,001h,006h,001h,011h,00Eh,000h ; 250
	.db 011h,015h,015h,015h,015h,015h,01Fh,000h ; 251
	.db 00Eh,011h,001h,007h,001h,011h,00Eh,000h ; 252
	.db 015h,015h,015h,015h,015h,015h,01Fh,001h ; 253
	.db 011h,011h,011h,00Fh,001h,001h,001h,000h ; 254
	.db 000h,000h,000h,000h,000h,000h,000h,01Fh ; 255
fontEnd: