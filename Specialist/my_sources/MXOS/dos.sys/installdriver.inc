;+---------------------------------------------------------------------------
; MXOS
; Установить драйвер устройства
;
; На входе
;  a - диск
;  hl - адрес драйвера
;
; На выходе
;  bc, de, hl - сохраняются
;
; 2013-12-12 Дизассемблировано vinxru
;----------------------------------------------------------------------------

installDriver:	; Сохранение регистров
		push	d
		push	h

		; Максимум дисков
		ani	7

		; Вычисление адреса в таблице дисков
		add	a
		mov	l, a
		mvi	h, 0
		lxi	d, v_drives
		dad	d

		; Установка драйвера
		pop	d
		mov	m, e
		inx	h
		mov	m, d

		; Восстановление регистров
		xchg
		pop	d
		rrc

		; Выход
		ret		