;+---------------------------------------------------------------------------
; MXOS
; Сохранить FAT и корневой каталог на устройство
;
; На выходе
;  регистры bc,de,hl сохраняются
;
; 2013-12-12 Дизассемблировано vinxru
;----------------------------------------------------------------------------

saveFatDir:	; Сохраняем регистры
		push	d

		; Режим - запись
		mvi	e, 1	

		; Переход к общему коду			
		jmp	loadFatDir_0

;----------------------------------------------------------------------------
; Загрузить FAT и корневой каталог с устройства
;
; На выходе
;  регистры bc,de,hl сохраняются
;----------------------------------------------------------------------------

loadFatDir:	; Сохраняем регистры
		push	d

		; Режим - чтение
		mvi	e, 2

loadFatDir_0:	; Сохраняем регистры
		push	h

		; Чтение/запись 1024 байт с начала диска в FB00h
		lxi	h, diskDirectoryL
		mvi	d, 3		; Сектор
loadFatDir_1:	 call	j_diskDriver
		 dcr	h
		 dcr	d
		jp	loadFatDir_1

		; Восстанавливаем регистры и выходим
		pop	h
		pop	d
		ret