;+---------------------------------------------------------------------------
; MXOS
; Обработка служебных кодов при выводе символа (продолжение)
;
; 2013-12-12 Дизассемблировано vinxru
;----------------------------------------------------------------------------

; ---------------------------------------------------------------------------
; Обработка кода 0Ah. Перевод строки

printChar_c0A:	; cursorX = 0
		mvi	h, 0

		; Продолжение в printChar_c1A

; ---------------------------------------------------------------------------
; Обработка кода 1Ah. Вниз

printChar_c1A:	; Если cursorY < 246, то cursorY += 10 и выход
		mov	a, l
		adi	10
		jnc	saveVCursorLA

		; Сохраняем положение курсора (изменен только cursorX)
		shld	v_cursorY

		; Далее прокрутка экрана вверх