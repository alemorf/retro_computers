;+---------------------------------------------------------------------------
; MXOS
; Вывод байта на принтер
;
; На входе 
;   c - байт
;
; На выходе 
;   af, bc, de, hl - cохраняются
;
; 2013-12-12 Дизассемблировано vinxru
;----------------------------------------------------------------------------

printer:	; Сохраняем регистры
		push	psw

		; Режим порта расширения
		mvi	a, 90h
		sta	IO_PROG+3

		; Выводим байт на принтер
		mov	a, c		
		cma
		sta	IO_PROG+1

printer_loop:	; Выход	при нажатии любой клавиши
		lda	IO_KEYB_B	
		ani	2
		jz	printer_ret

		; Ждем пока принтер не будет готов
		lda	IO_PROG		
		ani	40h
		jnz	printer_loop
		
		; Строб
		mvi	a, 3		
		sta	IO_PROG+2
		xra	a
		sta	IO_PROG+2

printer_ret:	; Восстаналвиаем регистры
		pop	psw
		ret