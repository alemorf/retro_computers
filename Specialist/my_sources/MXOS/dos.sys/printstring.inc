;+---------------------------------------------------------------------------
; MXOS
; Вывод строки на экран
;
; На входе
;  hl - строка
;
; На выходе
;  af, bc, de - сохраняются
;
; 2013-12-12 Дизассемблировано vinxru
;----------------------------------------------------------------------------

printString:	; Сохраняем регистры
		push	b
		push	psw

printString_1:	; Читаем очередной байт
		mov	a, m
		
		; Если прочитан 0, выходим
		ora	a
		jz	printString_2

		; Выводим байт на экран
		mov	c, a
		call	printChar

		; Следующий байт
		inx	h
		jmp	printString_1

; ---------------------------------------------------------------------------

printString_2:	; Восстанавливаем регистры
		pop	psw
		pop	b
		ret		