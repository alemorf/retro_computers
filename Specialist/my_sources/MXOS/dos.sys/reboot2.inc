;+---------------------------------------------------------------------------
; MXOS
; Перезагрузка (продолжение)
;
; 2013-12-12 Дизассемблировано vinxru
;----------------------------------------------------------------------------

reboot2:	; Очищаем экран
		call	clearScreen

		; Проверяем, нажата ли какая нибудь клавиша
		call	j_keyScan

		; Выводим версию ОС на экран
		push	psw
		 lxi	h, aBios4_40	; "\fBIOS 4.40"
		 call	printString1
		pop	psw

		; Если не нажата ни одна клавиша, запускаем файл с RAM-диска
		inr	a
		jz	j_reboot3

		; Загружаем программу с ленты (без контроля КС) и запускаем
		call	tapeLoadInt
		lhld	v_tapeAddr
		pchl

; ---------------------------------------------------------------------------

aBios4_40:	.db 0Ch
		.text "BIOS 4.40"
		.db 0
