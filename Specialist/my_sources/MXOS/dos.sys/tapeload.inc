;+---------------------------------------------------------------------------
; MXOS
; Загрузка программы с ленты. КС загружается, но не проверяется.
;
; В случае ошибки управление передается по адресу в v_tapeError
;
; На выходе 
;  bc - контольная сумма
;  hl, v_tapeAddr - адрес загруженной программы
;
; 2013-12-12 Дизассемблировано vinxru
;----------------------------------------------------------------------------

tapeLoad:	; Загружаем файл с ленты без загрузки КС
		call	tapeLoadInt

		; Читаем КС
		mvi	a, 8
		call	j_tapeRead
		mov	c, a
		mvi	a, 8
		call	j_tapeRead
		mov	b, a

		; В HL возврааем адрес запуска
		lhld	v_tapeAddr
		ret