;+---------------------------------------------------------------------------
; MXOS
; Загрузка программы с ленты. КС не загружается.
;
; В случае ошибки управление передается по адресу в v_tapeError
;
; На выходе 
;  v_tapeAddr - адрес загруженной программы
;
; 2013-12-12 Дизассемблировано vinxru
;----------------------------------------------------------------------------

tapeLoadInt:	; Ждем пилот-тон и читаем слово - это адрес загрузки программы
		mvi	a, 0FFh
		call	tapeRead		
		mov	l, a
		mvi	a, 8
		call	tapeRead
		mov	h, a
		shld	v_tapeAddr

		; Читаем следующее слово - это конец программы
		mvi	a, 8
		call	tapeRead
		mov	e, a
		mvi	a, 8
		call	tapeRead
		mov	d, a

		; Читаем тело программы
loc_C414:	mvi	a, 8		
loc_C416:	call	tapeRead
		mov	m, a
		call	cmp_hl_de
		inx	h
		jnz	loc_C414

		; Выходим не запуская
		ret

; ---------------------------------------------------------------------------
; Не используется

tapeLoadAny:	mvi	a, 0FFh
		jmp	loc_C416