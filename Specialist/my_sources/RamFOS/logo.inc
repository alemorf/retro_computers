	.db 000h,000h,000h,000h,000h,000h,000h,000h,000h,000h,000h,001h,003h,007h,00Fh,00Fh ; 0
	.db 01Fh,03Fh,03Fh,07Fh,07Fh,07Fh,0FFh,0FFh,0FFh,0FFh,0FFh,0FFh,0FFh,0FFh,0FFh,07Fh ; 1
	.db 07Fh,01Fh,007h,000h,000h,000h,000h,000h,000h,000h,000h,000h,000h,000h,000h,003h ; 2
	.db 01Fh,07Fh,0FFh,0FFh,0FFh,0FCh,0F0h,0E0h,0C0h,0C0h,080h,080h,080h,000h,000h,000h ; 3
	.db 000h,000h,000h,080h,0E0h,0FFh,0FFh,0FFh,0FFh,0FFh,000h,000h,000h,000h,000h,000h ; 4
	.db 000h,000h,000h,000h,000h,000h,0FFh,0FFh,0FFh,0FFh,0FFh,0F0h,000h,000h,000h,000h ; 5
	.db 000h,000h,000h,000h,000h,000h,000h,000h,000h,000h,000h,000h,0FFh,0FFh,0FFh,0FFh ; 6
	.db 0FFh,000h,000h,000h,000h,000h,000h,000h,000h,000h,000h,000h,000h,0FFh,0FFh,0FFh ; 7
	.db 0FFh,0FFh,000h,000h,000h,001h,001h,001h,003h,003h,003h,007h,007h,007h,00Fh,00Fh ; 8
	.db 00Fh,01Fh,01Fh,0FFh,0FFh,0FFh,0FFh,0FFh,000h,000h,000h,000h,000h,000h,000h,000h ; 9
	.db 000h,000h,000h,000h,0FFh,0FFh,0FFh,0FFh,0FFh,000h,000h,0FFh,0FFh,0FFh,0FFh,0FFh ; 10
	.db 0F8h,0F8h,0F0h,0F0h,0F0h,0E0h,0E0h,0E0h,0C0h,0C0h,0C0h,081h,081h,081h,003h,000h ; 11
	.db 000h,000h,000h,000h,000h,000h,000h,000h,000h,000h,000h,0FFh,0FFh,0FFh,0FFh,0FFh ; 12
	.db 000h,000h,0FFh,0FFh,0FFh,0FFh,0FFh,01Fh,01Fh,03Fh,03Fh,03Fh,07Fh,07Fh,07Fh,0FEh ; 13
	.db 0FEh,0FEh,0FCh,0FCh,0FCh,0F8h,000h,000h,000h,000h,000h,000h,000h,000h,000h,000h ; 14
	.db 000h,000h,0FFh,0FFh,0FFh,0FFh,0FFh,000h,000h,0F0h,0E0h,0E0h,0E0h,0C0h,0C1h,0C3h ; 15
	.db 083h,087h,087h,00Fh,00Fh,00Fh,00Fh,00Fh,00Fh,00Fh,007h,003h,000h,000h,000h,000h ; 16
	.db 000h,000h,000h,000h,000h,000h,000h,000h,000h,0FFh,0FFh,0FFh,0FFh,0FFh,000h,000h ; 17
	.db 003h,00Fh,03Fh,07Fh,0FFh,0FEh,0F8h,0F0h,0FFh,0FFh,0FFh,0FFh,0E0h,0E0h,0F0h,0FFh ; 18
	.db 0FFh,0FFh,0FFh,0FFh,000h,000h,000h,000h,000h,000h,000h,000h,000h,000h,000h,000h ; 19
	.db 0FFh,0FFh,0FFh,0FFh,0FFh,000h,000h,0FEh,0FFh,0FFh,0FFh,0FFh,01Fh,00Fh,00Fh,0FFh ; 20
	.db 0FFh,0FFh,0FFh,000h,000h,07Fh,0FFh,0FEh,0F8h,0F0h,080h,000h,000h,000h,000h,000h ; 21
	.db 000h,000h,000h,000h,000h,000h,000h,0FFh,0FFh,0FFh,0FFh,0FFh,000h,000h,000h,080h ; 22
	.db 0C0h,0C0h,0E0h,0E0h,0E0h,0E1h,0E1h,0E1h,0C3h,0C3h,003h,007h,087h,007h,00Fh,00Fh ; 23
	.db 00Fh,01Fh,000h,000h,000h,000h,000h,000h,000h,000h,000h,000h,000h,000h,0FFh,0FFh ; 24
	.db 0FFh,0FFh,0FFh,000h,000h,03Fh,07Fh,07Fh,07Fh,0FEh,0FEh,0FEh,0FCh,0FCh,0FCh,0F8h ; 25
	.db 0F8h,0F8h,0F0h,0F0h,0FFh,0FFh,0FFh,0FFh,0FFh,000h,000h,000h,000h,000h,000h,000h ; 26
	.db 000h,000h,000h,000h,000h,0FFh,0FFh,0FFh,0FFh,0FFh,000h,000h,080h,001h,001h,001h ; 27
	.db 003h,003h,003h,007h,007h,007h,00Fh,00Fh,00Fh,01Fh,01Fh,0FFh,0FFh,0FFh,0FFh,0FFh ; 28
	.db 007h,00Fh,00Fh,00Fh,000h,000h,000h,000h,000h,000h,000h,000h,0FFh,0FFh,0FFh,0FFh ; 29
	.db 0FFh,000h,000h,0FFh,0FFh,0FFh,0FFh,0F8h,0F8h,0F8h,0F0h,0F0h,0F0h,0E0h,0E0h,0E0h ; 30
	.db 0C1h,0C1h,0F9h,0F3h,0F3h,0F3h,0E7h,0E0h,0C0h,0C0h,0C0h,000h,000h,000h,000h,000h ; 31
	.db 000h,000h,000h,0FFh,0FFh,0FFh,0FFh,0FFh,000h,000h,0FFh,0FFh,0FFh,0FFh,03Fh,03Fh ; 32
	.db 03Fh,07Fh,07Fh,07Fh,0FFh,0FFh,0FFh,0FFh,0FFh,0FFh,0FFh,0FEh,0FCh,0F8h,000h,000h ; 33
	.db 000h,000h,000h,000h,000h,000h,000h,000h,000h,000h,0FFh,0FFh,0FFh,0FFh,0FFh,000h ; 34
	.db 000h,0E0h,0C0h,0C1h,0C3h,087h,08Fh,09Fh,03Fh,07Fh,0FFh,0FFh,0FBh,0F3h,0E7h,0C7h ; 35
	.db 087h,00Fh,00Fh,00Fh,01Fh,000h,000h,000h,000h,000h,000h,000h,000h,000h,000h,000h ; 36
	.db 000h,0FFh,0FFh,0FFh,0FFh,0FFh,000h,000h,07Fh,0FFh,0FFh,0FFh,0FEh,0FEh,0FEh,0FCh ; 37
	.db 0FCh,0FCh,0F8h,0F8h,0F8h,0F0h,0F0h,0F0h,0E0h,0E0h,0E0h,0C0h,000h,000h,000h,000h ; 38
	.db 000h,000h,000h,000h,000h,000h,000h,000h,0FFh,0FFh,0FFh,0FFh,0FFh,000h,000h,080h ; 39
	.db 000h,003h,007h,007h,00Fh,001h,000h,000h,003h,01Fh,03Fh,07Fh,0FEh,0FEh,0FFh,0FFh ; 40
	.db 0FFh,0FFh,03Fh,000h,000h,000h,000h,000h,000h,000h,000h,000h,000h,000h,000h,0FFh ; 41
	.db 0FFh,0FFh,0FFh,0FFh,000h,000h,01Fh,0FFh,0FFh,0FFh,0FFh,0F0h,0E0h,001h,03Fh,0FFh ; 42
	.db 0FFh,0F9h,003h,003h,00Fh,0FFh,0FFh,0FFh,0E7h,087h,000h,000h,000h,000h,000h,000h ; 43
	.db 000h,000h,000h,000h,000h,000h,0FFh,0FFh,0FFh,0FFh,0FFh,000h,000h,0F8h,0FEh,0FEh ; 44
	.db 0FFh,0FFh,0FFh,07Fh,0FEh,0FEh,0FEh,0FCh,0FCh,0FCh,0F8h,0F8h,0F8h,0FFh,0FFh,0FFh ; 45
	.db 0FFh,000h,000h,000h,000h,000h,000h,000h,000h,000h,000h,000h,000h,0FFh,0FFh,0FFh ; 46
	.db 0FFh,0FFh,000h,000h,000h,000h,000h,000h,001h,001h,001h,003h,003h,003h,007h,007h ; 47
	.db 007h,00Fh,00Fh,07Fh,0FFh,0FFh,0FFh,0FEh,000h,000h,000h,000h,000h,000h,000h,000h ; 48
	.db 000h,000h,000h,000h,0FFh,0FFh,0FFh,0FFh,0FFh,000h,000h,07Fh,0FFh,0FFh,0FFh,0FFh ; 49
	.db 0FCh,0FCh,0F8h,0F8h,0F8h,0F0h,0F0h,0F0h,0E0h,0E0h,0C0h,0C1h,081h,001h,003h,000h ; 50
	.db 000h,000h,000h,000h,000h,000h,000h,000h,000h,000h,000h,0FFh,0FFh,0FFh,0FFh,0FFh ; 51
	.db 000h,000h,0FFh,0FFh,0FFh,0FFh,0FFh,01Fh,01Fh,03Fh,03Fh,03Fh,07Fh,07Fh,07Fh,0FEh ; 52
	.db 0FEh,0FEh,0FCh,0FCh,0FCh,0F8h,000h,000h,000h,000h,000h,000h,000h,000h,000h,000h ; 53
	.db 000h,000h,0FFh,0FFh,0FFh,0FFh,0FFh,000h,000h,0F0h,0E0h,0E0h,0E0h,0C1h,0C1h,0C1h ; 54
	.db 083h,083h,083h,007h,007h,007h,00Fh,00Fh,00Fh,01Fh,01Fh,01Fh,03Fh,000h,000h,000h ; 55
	.db 000h,000h,000h,000h,000h,000h,000h,000h,000h,0FFh,0FFh,0FFh,0FFh,0FFh,000h,000h ; 56
	.db 07Fh,0FEh,0FEh,0FEh,0FCh,0FCh,0FCh,0F9h,0FBh,0FFh,0FFh,0FFh,0FFh,0FFh,0FEh,0FCh ; 57
	.db 0F8h,0F0h,0E0h,0C0h,000h,000h,000h,000h,000h,000h,000h,000h,000h,000h,000h,000h ; 58
	.db 0FFh,0FFh,0FFh,0FFh,0FFh,000h,000h,003h,007h,00Fh,01Fh,03Fh,07Fh,0FFh,0FFh,0FFh ; 59
	.db 0FFh,0FFh,0DFh,09Fh,03Fh,03Fh,03Fh,07Fh,07Fh,07Fh,0FEh,000h,000h,000h,000h,000h ; 60
	.db 000h,000h,000h,000h,000h,000h,000h,0FFh,0FFh,0FFh,0FFh,0FFh,000h,000h,0F8h,0F8h ; 61
	.db 0F8h,0F8h,0F0h,0F0h,0F0h,0E1h,0E1h,0E1h,0C3h,0C3h,0C3h,083h,083h,083h,003h,001h ; 62
	.db 000h,000h,000h,000h,000h,000h,000h,000h,000h,000h,000h,000h,000h,000h,0FFh,0FFh ; 63
	.db 0FFh,0FFh,0FFh,000h,000h,000h,003h,00Fh,01Fh,03Fh,07Fh,0FFh,0FEh,0FCh,0FCh,0F8h ; 64
	.db 0F8h,0F8h,0F8h,0FCh,0FFh,0FFh,0FFh,0FFh,03Fh,000h,000h,000h,000h,000h,000h,000h ; 65
	.db 000h,000h,000h,000h,000h,0FFh,0FFh,0FFh,0FFh,0FFh,000h,000h,07Fh,0FFh,0FFh,0FFh ; 66
	.db 0FFh,080h,000h,000h,000h,000h,000h,000h,000h,000h,000h,0FFh,0FFh,0FFh,0FFh,0FFh ; 67
	.db 000h,000h,000h,000h,000h,000h,000h,000h,000h,000h,000h,000h,0FFh,0FFh,0FFh,0FFh ; 68
	.db 0FFh,03Eh,07Eh,0FCh,0FCh,0F8h,0F8h,0F0h,000h,000h,000h,000h,000h,000h,000h,000h ; 69
	.db 001h,001h,0FFh,0FFh,0FFh,0FFh,0FFh,000h,000h,000h,000h,000h,000h,000h,000h,000h ; 70
	.db 000h,000h,000h,080h,080h,080h,000h,000h,000h,000h,00Fh,01Fh,01Fh,01Fh,03Fh,03Fh ; 71
	.db 03Fh,07Fh,07Fh,07Fh,0FEh,0FEh,0FEh,0FCh,0FCh,0FCh,0F8h,0F8h,0F8h,0F0h,000h,000h ; 72
	.db 000h,000h,000h,000h,000h,000h,000h,000h,000h,000h,000h,000h,000h,000h,000h,000h ; 73
	.db 000h,0C3h,0CFh,0BFh,0FFh,0FFh,0FFh,0C3h,083h,003h,003h,007h,007h,007h,00Fh,00Fh ; 74
	.db 00Fh,01Fh,01Fh,01Fh,03Fh,000h,000h,000h,000h,000h,000h,000h,000h,000h,000h,000h ; 75
	.db 000h,000h,000h,000h,000h,000h,000h,000h,0F0h,0F8h,0FDh,0FFh,0FFh,0FFh,0FEh,0FCh ; 76
	.db 0F8h,0F8h,0F0h,0F0h,0F0h,0E0h,0E0h,0E0h,0C0h,0C0h,0C0h,081h,000h,000h,000h,000h ; 77
	.db 000h,000h,000h,000h,000h,000h,000h,000h,000h,000h,000h,000h,000h,000h,000h,01Fh ; 78
	.db 07Fh,0FFh,0FFh,0FFh,0FFh,03Fh,01Fh,01Fh,01Fh,03Fh,03Fh,03Fh,07Fh,07Fh,07Fh,0FFh ; 79
	.db 0FFh,0FFh,0FFh,000h,000h,000h,000h,000h,000h,000h,000h,000h,000h,000h,000h,000h ; 80
	.db 000h,000h,000h,000h,000h,000h,080h,0C0h,0E0h,0E0h,0E0h,0E0h,0E0h,0C0h,0C0h,0C0h ; 81
	.db 080h,080h,080h,000h,000h,000h,0FFh,0FFh,0FFh,0FFh,000h,000h,000h,000h,000h,000h ; 82
	.db 000h,000h,000h,000h,000h,000h,000h,000h,000h,000h,000h,000h,000h,000h,000h,000h ; 83
	.db 000h,000h,000h,000h,000h,000h,000h,000h,000h,000h,000h,000h,000h,0FFh,0FFh,0FFh ; 84
	.db 0FFh,000h,000h,000h,000h,000h,000h,000h,000h,000h,000h,000h,000h,000h,000h,001h ; 85
	.db 001h,001h,003h,003h,003h,007h,007h,007h,00Fh,00Fh,00Fh,01Fh,01Fh,01Fh,03Fh,03Fh ; 86
	.db 03Fh,07Fh,07Fh,07Fh,0FEh,0FEh,0FEh,0FCh,000h,000h,000h,000h,000h,000h,000h,000h ; 87
	.db 000h,000h,000h,000h,0FFh,0FFh,0FFh,0FFh,0FFh,0FFh,0FFh,0FFh,0F7h,0F7h,0FFh,0EFh ; 88
	.db 0EFh,0EFh,0CFh,0CFh,0CFh,09Fh,09Fh,09Fh,01Fh,01Fh,01Fh,01Fh,01Fh,03Fh,03Fh,000h ; 89
	.db 000h,000h,000h,000h,000h,000h,000h,000h,000h,000h,000h,0F0h,0E0h,0E0h,0E0h,0E1h ; 90
	.db 0E1h,0E3h,0C3h,0C7h,0C7h,0CFh,0CFh,0DFh,0DFh,0BFh,0BEh,0FEh,0FCh,0F8h,0F8h,0F1h ; 91
	.db 0F1h,0E1h,0E3h,0C3h,0C3h,087h,000h,000h,000h,000h,000h,000h,000h,000h,000h,000h ; 92
	.db 000h,000h,07Fh,07Fh,0FFh,0FFh,0FFh,0FFh,0FFh,0EFh,0FFh,0DFh,0DFh,0BFh,0BFh,03Fh ; 93
	.db 07Fh,07Fh,07Fh,0FEh,0FEh,0FEh,0FCh,0FCh,0FCh,0FFh,0FFh,0FFh,0FFh,000h,000h,000h ; 94
	.db 000h,000h,000h,000h,000h,000h,000h,000h,000h,0F8h,0F8h,0F0h,0F0h,0F0h,0E0h,0E0h ; 95
	.db 0E0h,0C0h,0C0h,0C0h,080h,080h,080h,000h,000h,000h,000h,001h,003h,007h,00Fh,01Fh ; 96
	.db 0FFh,0FFh,0FFh,0FFh,000h,000h,000h,000h,000h,000h,000h,000h,000h,000h,000h,000h ; 97
	.db 07Fh,03Fh,03Fh,03Fh,01Fh,01Fh,01Fh,01Fh,00Fh,00Fh,00Fh,007h,007h,00Fh,01Fh,03Fh ; 98
	.db 07Fh,0FFh,0FFh,0FEh,0FCh,0F8h,0F0h,0E0h,0C0h,080h,000h,000h,000h,000h,000h,000h ; 99
	.db 000h,000h,000h,000h,000h,000h,000h,080h,0C0h,0C0h,0C0h,0E0h,0E1h,0E3h,0F7h,0FFh ; 100
	.db 0FFh,0FFh,0FFh,0FFh,0FFh,0FFh,0FFh,0FFh,0FFh,07Fh,07Fh,07Fh,03Fh,03Fh,01Fh,01Fh ; 101
	.db 01Fh,00Fh,000h,000h,000h,000h,000h,000h,000h,000h,000h,000h,000h,000h,00Fh,01Fh ; 102
	.db 03Fh,07Fh,0FFh,0FEh,0FCh,0F8h,0F0h,0E0h,0C0h,080h,000h,000h,000h,000h,080h,080h ; 103
	.db 080h,0C0h,0C0h,0C0h,0E0h,0E0h,0E0h,0F0h,0F0h,000h,000h,000h,000h,000h,000h,000h ; 104
	.db 000h,000h,000h,000h,000h,0F0h,0E0h,0C0h,080h,000h,000h,000h,000h,000h,000h,000h ; 105
	.db 000h,000h,000h,000h,000h,000h,000h,000h,000h,000h,000h,000h,000h,000h,000h,000h ; 106
	.db 000h,000h,000h,000h,000h,000h,00Fh,01Fh,03Fh,038h,030h,000h,001h,003h,007h,00Fh ; 107
	.db 01Eh,03Ch,07Fh,0FFh,0FFh,000h,000h,000h,000h,000h,000h,000h,000h,000h,000h,000h ; 108
	.db 000h,000h,000h,000h,000h,000h,000h,000h,000h,000h,000h,000h,000h,080h,0C0h,0E0h ; 109
	.db 0E0h,0E0h,0E0h,0C0h,0C0h,080h,000h,020h,060h,0E0h,0E0h,0E0h,000h,000h,000h,000h ; 110
	.db 000h,000h,000h,000h,000h,000h,000h,000h,000h,000h,000h,000h,000h,000h,000h,000h ; 111
	.db 000h,000h