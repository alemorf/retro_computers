;+---------------------------------------------------------------------------
; RAMFOS
; Стандартная точка входа C848
; Воспроизвести звуковой сигнал через ВИ53
;
; На входе:
;  de - частота
;  bс - длительность
;  с  - ждать завершения предыдущего звукового сигнала
;  z  - ждать завершения этого звукового сигнала
;
; 2013-11-01 Дизассемблировано vinxru
;----------------------------------------------------------------------------

beep:		; Ожидание заверения прошлого звукового сигнала, если C
		cc	waitBeep		

		; de-частота, bс-длительность, z-ждать
setTimer:	push	h
		 lxi	h, IO_TIMER
		 mov	m, e
		 mov	m, d
		 inx	h
		 inx	h
		 mov	m, c
		 mov	m, b
		pop	h

		; Ожидание заверения этого звукового сигнала, если Z
		rnz

waitBeep:	; Ожидание заверения звукового сигнала
		push	psw		
waitBeep_0:	 lda	IO_EXT_A
		 ani	1
		jz	waitBeep_0
		pop	psw
		ret