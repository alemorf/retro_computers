;+---------------------------------------------------------------------------
; RAMFOS
; Определение размера ДОЗУ
;
; На входе
;  а - максимальный номер страницы, константа MAX_ARAM_PAGE
;
; На выходе
;   Z - ДОЗУ найдено
;  NZ - ДОЗУ не найдено
;
; 2013-11-01 Дизассемблировано vinxru
;----------------------------------------------------------------------------

checkARAM_0:	; Уменьшаем счетчик страниц ДОЗУ
		dcr	a		

		; Если это была	нуленвая страница, то выходим
		rm			

checkARAM:	; Точка входа

		; Сохраняем номер последней страницы RAM-диска
		sta	v_aramMaxPage

		; Записываем на	диск номер страницы+1 и тут же читаем
		mov	c, a		
		inr	c
		call	j_pageWriteAny
		call	j_pageReadAny
		dcr	c
		cmp	c

		; Если запись не удалась, то значит нет такой страницы
		jnz	checkARAM_0 

		; Если это была	нулевая страница, то выходим
		ora	a		
		rz

		; Читаем с диска -1 байт.
		; Если на диске	-1 записан байт	+1 относительно	проверяемой страницы, то значит страницы нет
		dcr	a		
		call	j_pageReadAny
		dcr	c
		inr	a
		cmp	c		
		jz	checkARAM_0

		; Выход с флагом Z
		cmp	a		
		ret