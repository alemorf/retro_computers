;+---------------------------------------------------------------------------
; RAMFOS
; Исправленная функция определения размера ДОЗУ
;
; На входе
;  а - максимальный номер страницы, константа MAX_ARAM_PAGE
;
; На выходе
;  NZ - ДОЗУ найдено (наоборот отновительно стандратной функции)
;   Z - ДОЗУ не найдено
;
; 2013-11-01 Разработано vinxru
;----------------------------------------------------------------------------

checkARAM:	 ; Записываем во все страницы порядковые номера от большей к меньшей
		 mov	c, a		
		 inr	c
		 call	j_pageWriteAny
		 dcr	a
		jp	checkARAM

		; Читаем номера. Если номер прочитан корректно, значит есть такая страница
		; a = -1

checkARAM_1:	 ; Читаем следующую страницу
		 inr	a
		 call	j_pageReadAny		
		 ; Должен быть записан номер страницы+1, если нет, то выходим
		 dcr	c
		 cmp	c		 
		 jnz	checkARAM_2
                 ; Сохраняем номер последней страницы RAM-диска
		 sta	v_aramMaxPage
		 ; Это максимум, выходим
		 cpi	ARAM_MAX_PAGE		; ARAM_MAX_PAGE не может быть нулем!
		jnz	checkARAM_1
		 
checkARAM_2:	; Если ДОЗУ найдено, выходим в флагом NZ
		ora	a
		rnz		

		; В случае ошибки заносим в v_aramPages=0 и выходим с флагом Z
		sta	v_aramMaxPage
		ret		