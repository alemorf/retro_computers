;+---------------------------------------------------------------------------
; RAMFOS
; Очистить верхнюю строку
;
; 2013-11-01 Дизассемблировано vinxru
;----------------------------------------------------------------------------

clearTopLine2:	lxi	d, 0A0Ah	; строка 10, высота 10

;----------------------------------------------------------------------------
; RAMFOS
; Очистить произвольное кол-во строк
;
; На входе
;  d - номер строки, выше которой строки будут очищены. Сама строка не очищается
;  e - кол-во строк
;
; 2013-11-01 Дизассемблировано vinxru
;----------------------------------------------------------------------------

clearLine:	lda	v_inverse
		mvi	h, 90h			; Адрес
		mvi	b, 48			; Кол-во столбцов
clearRect_0:	 mov	l, d
		 mov	c, e		
clearRect_1:	  dcr	l
		  dcr	c		
		  mov	m, a
		  dcr	l
		  dcr	c
		  mov	m, a
		 jnz	clearRect_1
		 inr	h
		 dcr	b
		jnz	clearRect_0
		ret		