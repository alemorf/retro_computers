;+---------------------------------------------------------------------------
; RAMFOS
; Сравнить имя текущего файла с именем заданным пользователем. 
; И опционально, если совпало, то удалить файл.
;
; На входе
;  v_header  - Файл 1, который будет удален, если b & 20h
;  v_header2 - Файл 2
;
; На выходе
;  jz        - файл найден. Но если b & 20h, то флаги неопределены.
;
; 2013-11-01 Дизассемблировано vinxru
;----------------------------------------------------------------------------

compareFileName:; Сравнить идентификаторы и имена файлов 
		lxi	h, v_header2
		lxi	d, v_header
		mvi	c, 15
		call	memcmp_hl_de_c
		rnz

		; Если (b & 20h)==0 выходим (не удаляем)
		mov	a, b
		ani	20h
		rz

		; Переходим к функции fileDelete