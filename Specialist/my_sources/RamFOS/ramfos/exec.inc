;+---------------------------------------------------------------------------
; RAMFOS
; Выполнить программу
;
; На входе
;  hl - имя файла
;
; 2013-11-01 Дизассемблировано vinxru
;----------------------------------------------------------------------------

exec:		; Найти файл
		call	exec1

		; Если файл не найден, перезапустить ОС
		jnz	biosInit		

exec2:		; Помещаем адрес загрузки/запуска в de и стек.
		lhld	v_header_start
		push	h
		xchg
		; Загружаем файл без контроля CRC (потому что в случае запуска
		; RKS файла, программы расчета CRC уже не будет)
                jmp	fileLoadNoCheck

; ---------------------------------------------------------------------------

exec1:		; Устанвока имени файла
		call	fileSetName
		
		; Сначала искать файл на RAM-диске
		call	fileFind

		; Потом на ROM-диске
		mvi	b, 80h
		cnz	fileFindEx
		ret

