;+---------------------------------------------------------------------------
; RAMFOS
; Вызывается после создания/удаления файла
;
; Вход
;  hl - Первый байт после тела файла. У второй функции соответственно +2.
;
; 2013-11-01 Дизассемблировано vinxru
;----------------------------------------------------------------------------                   

fileChanged2: 	; Пропускаем два байта, они будут заполнены при просмотре.
		inx	h
		inx	h

fileChanged:    ; Обновляем указатель свободного места
		shld	v_pageFreePtr

		; Записываем значение 8 по этому адресу, что бы там ни 
		; в коем случае не было D3, D3, D3
		mvi	c, 8
		call	pageWrite

		; Звуковой сигнал
		dcr	c
		jmp	j_printChar
