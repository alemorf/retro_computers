;+---------------------------------------------------------------------------
; RAMFOS
; Стандартная точка входа F84B
; Поиск файла имя которого задано функцией fileSetName (F848)
;
; На входе
;   v_header2_name  - Имя файла для поиска
;
; На выходе
;   v_curFile       - Адрес текущего файла в ДОЗУ
;   v_header        - Заголовок файла
;   f_fileBodySize  - Длина файла без заголовка -1
;   f_fileSize      - Длина файла с заголовком
;   f_nextFile      - Адрес следующего файла в ДОЗУ
;   В ДОЗУ по адресу v_curFile + f_fileSize записывается v_curFile
;
; Изменяет переменные в случае ошибки в ДОЗУ. ДОЗУ не изменяется.
;   v_pageFreePtr   - Указатель на первый свободный байт
;   v_pageFreeTotal - Свободно байт
;
; 2013-11-01 Дизассемблировано vinxru
;----------------------------------------------------------------------------

fileFind:	; Начальная страница
		mvi	b, 0
fileFindEx:	 ; Ищем файл в странице из регистра B
		 call	fileFind1

		 ; ?
		 jz	fileLoadHeader2

		 ; Следующая страница (регистр B), если есть
		 call	pageNext
		jnc	fileFindEx
		ret