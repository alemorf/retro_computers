;----------------------------------------------------------------------------
; RAMFOS
; Поиск файла в странице имя которого задано функцией F848
;
; На входе
;   v_header2_name  - Имя файла для поиска
;   b, v_page       - Номер текущей страницы
;
; На выходе
;   v_curFile       - Адрес текущего файла в ДОЗУ
;   v_header        - Заголовок файла
;   f_fileBodySize  - Длина файла без заголовка - 1
;   f_fileSize      - Длина файла с заголовком
;   f_nextFile      - Адрес следующего файла в ДОЗУ
;   В ДОЗУ по адресу v_curFile + f_fileSize записывается v_curFile
;   v_pageFreePtr   - Указатель на первый свободный байт
;   v_pageFreeTotal - Свободно байт
;
; 2013-11-01 Дизассемблировано vinxru
;----------------------------------------------------------------------------

fileFind1:      ; Поиск происходит в два этапа
		; Сначала мы расчитываем v_pageFreePtr, v_pageFreeTotal
		push	b
		 mov	a, b
		 ori	10h
		 mov	b, a
		 call	fileFind1_0
		pop	b

		; А при втором проходе сравниваем имя файла

fileFind1_0:	; Получаем B - текущая страница, HL - начало страницы
		call	fileSetPage
fileFind2_1:	 ; Загружаем следующий заголовок файла
		 call	fileLoadHeader
		 ; Нет файлов, выходим с флагом NZ
		 rnz
		 ; Во втором проходе (b & 0x10 == 0) сравниваем имя файла
		 mov	a, b
		 ani	10h
		 cz	compareFileName
		 ; Если файл найден, выходим с флагом Z
		 rz
		 ; Продолжаем поиск со следующего файла
		 lhld	f_nextFile
		jmp	fileFind2_1
