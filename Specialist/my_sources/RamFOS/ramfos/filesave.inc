;+---------------------------------------------------------------------------
; RAMFOS
; Сохранить файл
;
; 2013-11-01 Дизассемблировано vinxru
;----------------------------------------------------------------------------

fileSave:	; Найти свободную страницу и рассчитать контрольную сумму
		call	fileFindFree
		rc

		; Общая функция
		jmp	fileSaveCom		

;----------------------------------------------------------------------------
; RAMFOS
; Сохранить файл с вводом имени с клавиатуры
;
; 2013-11-01 Дизассемблировано vinxru
; ---------------------------------------------------------------------------

fileSaveDlg:	; Вывод текста "Сохранить?"
		call	printStringEx
		.db C_INVERSE, C_BOTTOMLINE, ' ', 0F3h, 0CFh, 0C8h, 0D2h, 0C1h, 0CEh, 0C9h, 0D4h, 0D8h, 3Fh, C_NORMAL, 0

		; Ввод имени файла
		call	j_inputFileName
		rz

		; Поиск подходящей страницы
		call	fileFindFree

		; В случае ошибки вывести "мал диск" и ждать нажания ESC
		jc	outOfSpace

fileSaveCom:	; Запись заголовка файла на диск
		lxi	b, v_header2
		call	fileSaveHeaderAny

		; BC = начало файла, DE = длина файла - 1
		push	h
		 call	fileGetStartAndSize2
		 xchg
		 mov	c, l
		 mov	b, h
		pop	h

		; Запись тела файла (запись на диск по адресу HL из памяти BC длиной DE+1)
		call	pageWriteBlock 

		; Продолжение в fileChanged		