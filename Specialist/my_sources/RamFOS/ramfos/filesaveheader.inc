;+---------------------------------------------------------------------------
; RAMFOS
; Записать заговлок текущего файла на диск
;
; 2013-11-01 Дизассемблировано vinxru
;----------------------------------------------------------------------------

fileSaveHeader:
		; Устанавливаем флаг "файл не был сохранен"
		mvi	a, 8Bh
		sta	v_header_saved

		; Сохранение заголовка на диск
		lxi	b, v_header
		
;----------------------------------------------------------------------------
; RAMFOS
; Записать альтернативный заговлок файла на диск
; Используется для записи заговлока v_header2 при создании нового файла
;
; На входе
;  b - заголовок
;
; 2013-11-01 Дизассемблировано vinxru
;----------------------------------------------------------------------------

fileSaveHeaderAny:
		lxi	d, FILE_HEADER_SIZE-1
		lhld	v_curFile

		; Продолжение на pageWriteBlock
		