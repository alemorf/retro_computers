;+---------------------------------------------------------------------------
; RAMFOS
; Стандартная точка входа F845
; Получение имени последнего загруженного файла
;
; На входе
;  hl - имя файла (12 байт)
;
; 2013-11-01 Дизассемблировано vinxru
;----------------------------------------------------------------------------

fileGetName:	push	h
		push	d
		push	b
		lxi	d, v_header2_name
		xchg
		jmp	fileSetName_0

;----------------------------------------------------------------------------
; RAMFOS
; Стандартная точка входа F848
; Установка имя для функций сохаранения/поиска
;
; На входе
;  hl - имя файла (12 байт)
;
; 2013-11-01 Дизассемблировано vinxru
;----------------------------------------------------------------------------

fileSetName:	push	h
		push	d
		push	b
		lxi	d, v_header2_name
fileSetName_0:	mvi	c, 11
		jmp	memcpy_popa