;+---------------------------------------------------------------------------
; RAMFOS
; Сравнить текущий файл с магнитофоном
;
; Функция вызывается только из файловй панели.
;
; 2013-11-01 Дизассемблировано vinxru
;----------------------------------------------------------------------------

		; Чтение первых 15 байт заголовка файла в v_header и вывод его на экран
		; Потом чтение длины тела (первые 2 байта) в DE
		call	fileFromTapeCom

		; Это не критично, но флаг C на выходе функции не проверяется.

		; Адрес выбранного файла на диске
		lhld	v_curFile		 
verifyLoop:	 ; Читаем байт с диска
		 call	pageRead
		 ; Читаем байт с магнитофона
		 call	j_tapeRead
		 ; Если байты не равны, выводим ошибку
		 cmp	c
		 jnz	dlg_error
		 ; Увеличиваем адрес на диске
		 inx	h
		 ; Цикл (Так как првоерка в конце, файлы нулевой длины не смогут проверится)
		 dcx	d
		 mov	a, e
		 ora	d
		jnz	verifyLoop
		ret
