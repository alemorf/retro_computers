;+---------------------------------------------------------------------------
; RAMFOS
; Инверсия инверсии (Инверсия фона чернобелого экрана)
; Вызывается при выводе кода 8Ah и просто так
;
; 2013-11-01 Дизассемблировано vinxru
;----------------------------------------------------------------------------

changeInverse:	lda	v_inverse

;----------------------------------------------------------------------------
; RAMFOS
; Включение/выключение инверсии
;
; На входе
;  A=0    - Включить. (Вызывается при выводе кода 8Bh)
;  A=0FFh - Выключить.
;
; 2013-11-01 Дизассемблировано vinxru
;----------------------------------------------------------------------------

setInverseNeg:	cma

;----------------------------------------------------------------------------
; RAMFOS
; Включение/выключение инверсии
;
; На входе
;  A=0FFh - Включить. (Вызывается при выводе кода 8Ch)
;  A=0    - Выключить.
;
; 2013-11-01 Дизассемблировано vinxru
;----------------------------------------------------------------------------

setInverse:	sta	v_inverse
		ret