;+---------------------------------------------------------------------------
; RAMFOS
; Сравнить с расширение текущего файла
;
; На входе
;  hl - адрес
; 
; На выходе
;  z  - если блоки равны
; 
; 2013-11-01 Дизассемблировано vinxru
;----------------------------------------------------------------------------

memcmp_ext:	lxi	d, v_header_ext

;----------------------------------------------------------------------------
; RAMFOS
; Сравнить 3 байта ОЗУ
;
; На входе
;  hl - адрес 1
;  de - адрес 2
; 
; На выходе
;  z  - если блоки равны
; 
; 2013-11-01 Дизассемблировано vinxru
;----------------------------------------------------------------------------

memcmp_hl_de_3:	mvi	c, 3

;----------------------------------------------------------------------------
; RAMFOS
; Сравнить ОЗУ
;
; На входе
;  hl - адрес 1
;  de - адрес 2
;  с  - размер
; 
; На выходе
;  z  - если блоки равны
; 
; 2013-11-01 Дизассемблировано vinxru
;----------------------------------------------------------------------------

memcmp_hl_de_c:	 ; if(*de-- != *hl--) return;
		 ldax	d
		 cmp	m
		 inx	h
		 rnz
		 inx	d
		 dcr	c
		jnz	memcmp_hl_de_c
		ret
