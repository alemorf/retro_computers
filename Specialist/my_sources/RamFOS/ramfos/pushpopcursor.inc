;+---------------------------------------------------------------------------
; RAMFOS
; Запоминание курсора строки
; Вызывается при выводе кода 8Dh 
;
; 2013-11-01 Дизассемблировано vinxru
;----------------------------------------------------------------------------

pushCursorLine:	lhld	v_cursorPos
		shld	v_pushCursorLn
		ret
 
;----------------------------------------------------------------------------
; RAMFOS
; Восстановние кода цвета из стека
; Вызывается при выводе кода 87h
;
; 2013-11-01 Дизассемблировано vinxru
;----------------------------------------------------------------------------

popCursorLine:	lhld	v_pushCursorLn
		jmp	setCursorPosPx
		
;----------------------------------------------------------------------------
; RAMFOS
; Запоминание курсора экрана
; Вызывается при выводе кода 93h
;
; 2013-11-01 Дизассемблировано vinxru
;----------------------------------------------------------------------------

pushCursor:	lhld	v_cursorPos
		shld	v_pushCursor
		ret

;----------------------------------------------------------------------------
; RAMFOS
; Восстановление курсора экрана
; Вызывается при выводе кода 94h 
;
; 2013-11-01 Дизассемблировано vinxru
;----------------------------------------------------------------------------

popCursor:	lhld	v_pushCursor
setCursorPosPx:	shld	v_cursorPos
		ret

