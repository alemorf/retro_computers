;+---------------------------------------------------------------------------
; RAMFOS
; Устанвока цвета фона или символов
; Вызывается при выводе кодов A0-BFh
;
; 2013-11-01 Дизассемблировано vinxru
;----------------------------------------------------------------------------

setColorChar:   ; Переходим, если это символы B0-BFh
		cpi	10h
		jnc	setColorChar_1

		; Это символы А0-АFh

		; Младшие 4 бита будут цветом символов (B = A << 4)
		ani	0Fh
		rlc
		rlc
		rlc
		rlc
		mov	b, a

		; Оставляем цвет фона (A = v_color & 0xF)
		lda	v_color
		ani	0Fh

		; Устаналвиаем цвет (A | B)
		jmp	setColorChar_2

; ---------------------------------------------------------------------------

setColorChar_1:	; Младшие 4 бита будут цветом фона (B = A & 0x0F)
		ani	0Fh
		mov	b, a

		; Оставляем цвет символов (A = v_color & 0xF0)
		lda	v_color
		ani	0F0h

setColorChar_2:	; Устаналвиаем цвет (A | B)
		ora	b
		jmp	setColor		