;+---------------------------------------------------------------------------
; RAMFOS
; Стандартная точка входа C83C
; Устанвока/получения положения курсора. Координаты в символах.
;
; На входе
;  H - номер строки
;  L - номер колонки
;
; 2013-11-01 Дизассемблировано vinxru
;----------------------------------------------------------------------------

setCursorPos:	push	h
		push	psw

		; Поменять H L местами
		mov	a, l
		mov	l, h
		mov	h, a

		; l = l * 10 - 2
		mvi	a, -2
loc_CD1C:	 adi	10
		 dcr	l
		jp	loc_CD1C
		mov	l, a

		; h *= 3
		mvi	a, -3
loc_CD25:	 adi	3
		 dcr	h
		jp	loc_CD25
		mov	h, a

		; Сохранить положение курсора
		shld	v_cursorPos

		pop	psw
		pop	h
		ret