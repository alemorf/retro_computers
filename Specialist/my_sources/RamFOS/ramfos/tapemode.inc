;+---------------------------------------------------------------------------
; RAMFOS
; Переключение скорости записи на магнитофон и режима принтера
; Вызывается при нажатии на соответствующую клавишу
;
; 2013-11-01 Дизассемблировано vinxru
;----------------------------------------------------------------------------

tapeMode:	; Эта хитрая программа просто обменивает местами
		; v_tapePulseB,A -> v_tapePulseB1,A1 -> v_tapePulseB2,A2
		mvi	d, 4			; Надо сдвинуть 4 байта
tapeMode_0:	 mvi	e, 11			; Длина всего массива 12 байт
		 lxi	h, v_tapePresets-1	; Конец массива
		 lda	v_tapePulseB		; Загружаем первое значение, которое сразу же поместим в конец
tapeMode_1:	  mov	c, a			; Сдвигаем 11 байт
		  mov	a, m
		  mov	m, c
		  dcx	h
		  dcr	e
		 jnz	tapeMode_1
		 mov	m, a			; И сохраняем 12 байт. Прошлое значение мы уже поместили в начало массива
		 dcr	d			; Повторяем это 4 раза
		jnz	tapeMode_0

		; Меняем переменную v_tapeMode '0'->'1'->'2'->'0'
		lda	v_tapeMode
		inr	a
		cpi	'3'
		jnz	tapeMode_2
		 mvi	a, '0'
tapeMode_2:	sta	v_tapeMode

		; Возвращаемся в функцию опроса клавиатуры
		jmp	specialKeysRet
