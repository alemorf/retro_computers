;+---------------------------------------------------------------------------
; RAMFOS
; Стандартная точка входа C827
; Запись пилот тона на магнитофон
;
; Сохраняет регистры BC,DE,HL
;
; 2013-11-01 Дизассемблировано vinxru
;----------------------------------------------------------------------------

tapeWritePilot:	; Сохраняем BC, HL
		push	h
		push	b		

		; Длительность пилот-тона BC. Странный кусок кода.
		; bc = (40 - v_tapePulseAL)*514
		lhld	v_tapePulseA
		mvi	a, 40
		sub	h
		add	a
		mov	b, a
		mov	c, a		

tapeWritePilot_0:
		 ; Уменьшаем BC 
		 dcx	b

		 ; Задержка, регистры ничего полезного не содержат
		 dad	h
		 mov	a, b

		 ; Импульс А
		 call	tapePulseA		 

		 ; Повторять пока BC не нулевое
		 mov	a, b
		 ora	c
		jnz	tapeWritePilot_0

		; Восстаналиваем BC, HL
		pop	b
		pop	h
		ret
