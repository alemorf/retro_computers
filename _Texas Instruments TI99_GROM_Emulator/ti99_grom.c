// Эмулятор GROM для TI99
// Принцип работы я подсмотрел в чей то программе.
// (с) 2010 vinxru (aleksey.f.morozov@gmail.com)
// (с) <2013 ????

#include <mega32.h>

// Залито: Demonstration (1979)(Texas Instruments)[PHM 3001]

const flash unsigned char grom[] = {
170,1,1,0,0,0,96,12,0,0,0,0,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120,
2,18,148,120,188,64,120,188,32,64,188,125,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63,
160,126,72,6,98,63,6,98,112,146,32,65,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4,
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91,16,131,179,91,16,251,218,94,1,87,19,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0,
0
};

//----------------------------------------------------------------------------------------------------
// Используемые выводы

// A0..A7 микроконтроллера подключается к D7..D0 картриджа. (Внимение! A0 к D7!)

#define DDR_DATA     DDRA
#define PORT_DATA    PORTA
#define PIN_DATA     PINA

#define DDR_CONTROL  DDRD
#define PORT_CONTROL PORTD
#define PIN_CONTROL  PIND

#define MDIR         0x01 // D0 микроконтроллера подключается к MDIR   (вход.  Чтение/запись)
#define GREADY       0x02 // D1 микроконтроллера подключается к GREADY (выход. Данные готовы)
#define GSEL         0x04 // D2 микроконтроллера подключается к GSEL   (вход.  Выбор микросхемы)
#define MODE         0x08 // D3 микроконтроллера подключается к MODE   (вход.  Адрес/данные)

//----------------------------------------------------------------------------------------------------
// Переменные

unsigned int  address;   // Адрес.
unsigned char dataable;  // В буфере есть данные
unsigned char data;      // Буфер для данных
unsigned char grmaccess; // Режим чтения и записи адреса.

//----------------------------------------------------------------------------------------------------
// Чтение данных в буфер

inline void prefetchdata() {
  unsigned int nTmpAddress;
  dataable = 0;
  if(address>=0x6000) { // Область 0x6000 .. 0xFFFF
    nTmpAddress = address - 0x6000;
    nTmpAddress -= ((nTmpAddress >> 13) << 11);
    dataable = 1;
    data = grom[nTmpAddress];   
  }
  address++;
  grmaccess = 0;
}

//----------------------------------------------------------------------------------------------------

void main() {
  // Инициализация переменных
  address = 0;
  grmaccess = 0;
  data = 0;   
                              
  // Микроконтроллер не готов (замыкаем GREADY на землю)
  DDR_CONTROL = GREADY; 
  PORT_CONTROL = 0;
  
  for(;;) {
    // Выбран GROM (GSEL=0)
    if((PIN_CONTROL & GSEL)==0) {
      // Команда        
      switch (PIN_CONTROL & (MDIR|MODE)) {
        case 0x00: // Запись данных, не поддерживается
          prefetchdata();
          break;
        case MDIR: // Чтение данных
          if(dataable) {
            DDR_DATA = 0xFF;
            PORT_DATA = data;
          }
          prefetchdata();
          break;
        case MODE: // Установка адреса
          address <<= 8;
          address |= PIN_DATA;
          grmaccess++;
          if(grmaccess==1) break;
          prefetchdata();
          break;
        case MDIR|MODE: // Чтение адреса (не проверено, так как не используется программами)
          address = ((address&0xff)<<8) | (address&0xff); 
          grmaccess = 0;
          break;
      }             
                       
      // Микроконтроллер готов (освобождаем GREADY)
      DDR_CONTROL &= ~GREADY; 
      PORT_CONTROL = 0;
    
      // Ждем, пока компьютер не обработает данные
      while((PIN_CONTROL & GSEL)==0);  
    
      // Освобождаем шину данных
      DDR_DATA = 0x00;
      PORT_DATA = 0x00;

      // Микроконтроллер не готов (замыкаем GREADY на землю)
      DDR_CONTROL |= GREADY; 
    }
  }
}