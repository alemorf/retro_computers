		db 100
		dw names
		db 0
		dw dir1
		db 0F8h,0
		db 0,0,0,0,0
		db 0,0,0,0,0
		db 0,0,0,0,0

names		db "1 DIR1",0
		db "2 XFAFFQEF",0
		db "3 WQRF!!!!",0
		db "4 PSSRASDF",0
		db "5 DIR1",0
		db "6 XFAFFQEF",0
		db "7 WQRF!!!!",0
		db "8 PSSRASDF",0
		db "9 DIR1",0
		db "10 XFAFFQEF",0
		db "11 WQRF!!!!",0
		db "12 PSSRASDF",0
		db "13 DIR1",0
		db "14 XFAFFQEF",0
		db "15 WQRF!!!!",0
		db "16 PSSRASDF",0
		db "17 DIR1",0
		db "18 XFAFFQEF",0
		db "19 WQRF!!!!",0
		db "20 PSSRASDF",0
		db "21 DIR1",0
		db "22 XFAFFQEF",0
		db "23 WQRF!!!!",0
		db "24 PSSRASDF",0
		db "25 DIR1",0
		db "26 XFAFFQEF",0
		db "27 WQRF!!!!",0
		db "28 PSSRASDF",0
		db "29 DIR1",0
		db "30 XFAFFQEF",0
		db "31 WQRF!!!!",0
		db "32 PSSRASDF",0
		db "33 DIR1",0
		db "34 XFAFFQEF",0
		db "35 WQRF!!!!",0
		db "36 PSSRASDF",0
		db "37 DIR1",0
		db "38 XFAFFQEF",0
		db "39 WQRF!!!!",0
		db "40 PSSRASDF",0
		db "41 DIR1",0
		db "42 XFAFFQEF",0
		db "43 WQRF!!!!",0
		db "44 PSSRASDF",0
		db "45 DIR1",0
		db "46 XFAFFQEF",0
		db "47 WQRF!!!!",0
		db "48 PSSRASDF",0
		db "49 DIR1",0
		db "50 XFAFFQEF",0
		db "51 WQRF!!!!",0
		db "52 PSSRASDF",0
		db "53 DIR1",0
		db "54 XFAFFQEF",0
		db "55 WQRF!!!!",0
		db "56 PSSRASDF",0
		db "57 XFAFFQEF",0
		db "58 WQRF!!!!",0
		db "59 PSSRASDF",0
		db "60 DIR1",0
		db "61 XFAFFQEF",0
		db "62 WQRF!!!!",0
		db "63 PSSRASDF",0
		db "64 DIR1",0
		db "65 XFAFFQEF",0
		db "66 WQRF!!!!",0
		db "67 PSSRASDF",0
		db "68 DIR1",0
		db "69 XFAFFQEF",0
		db "70 WQRF!!!!",0
		db "71 PSSRASDF",0
		db "72 DIR1",0
		db "73 XFAFFQEF",0
		db "74 WQRF!!!!",0
		db "75 PSSRASDF",0
		db "76 DIR1",0
		db "77 XFAFFQEF",0
		db "78 WQRF!!!!",0
		db "79 PSSRASDF",0
		db "80 DIR1",0
		db "81 XFAFFQEF",0
		db "82 WQRF!!!!",0
		db "83 PSSRASDF",0
		db "84 DIR1",0
		db "85 XFAFFQEF",0
		db "86 WQRF!!!!",0
		db "87 PSS+RASDF",0
		db "88 DIR1",0
		db "89 XFAFFQEF",0
		db "90 WQRF!!!!",0
		db "91 PSSRASDF",0
		db "92 DIR1",0
		db "93 XFAFFQEF",0
		db "94 WQRF!!!!",0
		db "95 PSSRASDF",0
		db "96 DIR1",0
		db "97 XFAFFQEF",0
		db "98 WQRF!!!!",0
		db "99 PSSRASDF",0
		db "100 DIR1",0
		db 0
		db "XFAFFQEF",0
		db "WQRF!!!!",0
		db "PSSRASDF",0
		db "DIR1",0
		db "XFAFFQEF",0
		db "WQRF!!!!",0
		db "PSSRASDF",0
		db "DIR1",0
		db "XFAFFQEF",0
		db "WQRF!!!!",0
		db "PSSRASDF",0
		db "XFAFFQEF",0
		db "WQRF!!!!",0
		db "PSSRASDF",0
		db "DIR1",0
		db "XFAFFQEF",0
		db "WQRF!!!!",0
		db "PSSRASDF",0
		db "DIR1",0
		db "XFAFFQEF",0
		db "WQRF!!!!",0
		db "PSSRASDF",0
		db "DIR1",0
		db "XFAFFQEF",0
		db "WQRF!!!!",0
		db "PSSRASDF",0
		db "DIR1",0
		db "XFAFFQEF",0
		db "WQRF!!!!",0
		db "PSSRASDF",0
		db "DIR1",0
		db "XFAFFQEF",0
		db "WQRF!!!!",0
		db "PSSRASDF",0
		db "DIR1",0
		db "XFAFFQEF",0
		db "WQRF!!!!",0
		db "PSSRASDF",0
		db "DIR1",0
		db "XFAFFQEF",0
		db "WQRF!!!!",0
		db "PSSRASDF",0
		db "DIR1",0
		db "XFAFFQEF",0
		db "WQRF!!!!",0
		db "PSSRASDF",0
		db "DIR1",0
		db "XFAFFQEF",0
		db "WQRF!!!!",0
		db "PSSRASDF",0
		db "DIR1",0
		db "XFAFFQEF",0
		db "WQRF!!!!",0
		db "PSSRASDF",0
		db "DIR1",0
		db "XFAFFQEF",0
		db "WQRF!!!!",0
		db "PSSRASDF",0
		db "DIR1",0
		db "XFAFFQEF",0
		db "WQRF!!!!",0
		db "PSSRASDF",0
		db "DIR1",0
		db "XFAFFQEF",0
		db "WQRF!!!!",0
		db "PSSRASDF",0

dir1:           db 5
		dw names2
		db 0
		dw rootDir
		db 0,0F8h
		db 03Fh
		dw 0F754h
		dw 0
		db 0,0,0,0,0
		db 0,0,0,0,0

names2		db "..",0
		db "FILE1",0
		db "FILE2",0
		db "FILE3",0
		db "FILE4",0
